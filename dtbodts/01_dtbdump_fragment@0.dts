/dts-v1/;

/ {

	__fixups__ {
		accdet = "/fragment@5:target:0", "/fragment@33:target:0", "/fragment@35:target:0", "/fragment@62:target:0";
		audgpio = "/fragment@6:target:0";
		auxadc = "/fragment@42:target:0", "/fragment@43/__overlay__:io-channels:0";
		charger = "/fragment@40:target:0";
		chosen = "/fragment@0:target:0";
		consys = "/fragment@9:target:0";
		dsi_te = "/fragment@66:target:0";
		fpc = "/fragment@18:target:0";
		gpio = "/fragment@58:target:0";
		gpio_usage_mapping = "/fragment@57:target:0";
		gyro = "/fragment@61:target:0";
		i2c0 = "/fragment@25:target:0", "/fragment@26:target:0", "/fragment@45:target:0";
		i2c1 = "/fragment@46:target:0";
		i2c10 = "/fragment@55:target:0";
		i2c11 = "/fragment@56:target:0";
		i2c2 = "/fragment@27:target:0", "/fragment@47:target:0";
		i2c3 = "/fragment@28:target:0", "/fragment@48:target:0";
		i2c4 = "/fragment@15:target:0", "/fragment@49:target:0";
		i2c5 = "/fragment@50:target:0";
		i2c6 = "/fragment@16:target:0", "/fragment@24:target:0", "/fragment@29:target:0", "/fragment@51:target:0";
		i2c7 = "/fragment@52:target:0";
		i2c8 = "/fragment@53:target:0";
		i2c9 = "/fragment@54:target:0";
		irq_nfc = "/fragment@60:target:0";
		irtx_pwm = "/fragment@10:target:0";
		kd_camera_hw1 = "/fragment@79:target:0", "/fragment@83:target:0";
		keypad = "/fragment@81:target:0";
		lk_charger = "/fragment@39:target:0";
		main_pmic = "/fragment@68:target:0";
		md1_sim1_hot_plug_eint = "/fragment@70:target:0";
		md1_sim2_hot_plug_eint = "/fragment@71:target:0";
		md_auxadc = "/fragment@43:target:0";
		msdc1_ins = "/fragment@31:target:0", "/fragment@64:target:0";
		mt6370_pmu = "/fragment@12:target:0", "/fragment@32:target:0";
		mt6370_typec = "/fragment@13:target:0";
		mt_pmic_vcama1_ldo_reg = "/fragment@72:target:0", "/fragment@79/__overlay__:vcama_sub-supply:0", "/fragment@83/__overlay__:cam1_vcama-supply:0";
		mt_pmic_vcama2_ldo_reg = "/fragment@73:target:0", "/fragment@79/__overlay__:vcama-supply:0", "/fragment@83/__overlay__:cam2_vcama-supply:0", "/fragment@83/__overlay__:cam0_vcama-supply:0";
		mt_pmic_vcamd_ldo_reg = "/fragment@76:target:0", "/fragment@79/__overlay__:vcamd_sub-supply:0", "/fragment@83/__overlay__:cam2_vcamd-supply:0", "/fragment@83/__overlay__:cam1_vcamd-supply:0";
		mt_pmic_vcamio_ldo_reg = "/fragment@77:target:0", "/fragment@79/__overlay__:vcamio-supply:0", "/fragment@79/__overlay__:vcamio_sub-supply:0", "/fragment@79/__overlay__:vcamio_main2-supply:0", "/fragment@83/__overlay__:cam3_vcamio-supply:0", "/fragment@83/__overlay__:cam0_vcamio-supply:0", "/fragment@83/__overlay__:cam1_vcamio-supply:0", "/fragment@83/__overlay__:cam2_vcamio-supply:0";
		mt_pmic_vldo28_ldo_reg = "/fragment@78:target:0", "/fragment@79/__overlay__:vcamaf-supply:0", "/fragment@79/__overlay__:vcamaf_sub-supply:0", "/fragment@79/__overlay__:vcamaf_main2-supply:0", "/fragment@80/__overlay__:vtouch-supply:0";
		mt_pmic_vsim1_ldo_reg = "/fragment@74:target:0";
		mt_pmic_vsim2_ldo_reg = "/fragment@75:target:0";
		mtkfb = "/fragment@21:target:0";
		odm = "/fragment@1:target:0", "/fragment@22:target:0", "/fragment@36:target:0", "/fragment@41:target:0";
		otg_iddig = "/fragment@38:target:0";
		pio = "/fragment@4:target:0", "/fragment@7:target:0", "/fragment@8:target:0", "/fragment@11:target:0", "/fragment@12/__overlay__:mt6370,intr_gpio:0", "/fragment@13/__overlay__:mt6370pd,intr_gpio:0", "/fragment@14:target:0", "/fragment@15/__overlay__/spc@40:pdn_pin:0", "/fragment@15/__overlay__/spc@40:rst_pin:0", "/fragment@16/__overlay__/rt9465@4b:rt,en_gpio:0", "/fragment@16/__overlay__/rt9465@4b:rt,intr_gpio:0", "/fragment@18/__overlay__:interrupt-parent:0", "/fragment@19:target:0", "/fragment@20:target:0", "/fragment@22/__overlay__/lcm_power_gpio:gpio_lcd_ldo18_gpio:0", "/fragment@22/__overlay__/lcm_power_gpio:gpio_lcd_reset_gpio:0", "/fragment@22/__overlay__/lcm_power_gpio:gpio_lcd_bias_enp_gpio:0", "/fragment@22/__overlay__/lcm_power_gpio:gpio_lcd_bias_enn_gpio:0", "/fragment@23:target:0", "/fragment@26/__overlay__/tcm_touch@2c:interrupt-parent:0", "/fragment@26/__overlay__/tcm_touch@2c:synaptics,irq-gpio:0", "/fragment@26/__overlay__/tcm_touch@2c:synaptics,reset-gpio:0", "/fragment@26/__overlay__/tcm_touch@2c:synaptics,display-reset-gpio:0", "/fragment@27/__overlay__/exergen@44:exergen_pdn_pin:0", "/fragment@28/__overlay__/wireless_chg_rx@2b:irq-gpio:0", "/fragment@28/__overlay__/wireless_chg_rx@2b:trxset-gpio:0", "/fragment@28/__overlay__/wireless_chg_rx@2b:otgen-gpio:0", "/fragment@28/__overlay__/wireless_chg_rx@2b:pwrst-gpio:0", "/fragment@28/__overlay__/wireless_chg_rx@2b:chipen-gpio:0", "/fragment@28/__overlay__/spc@21:pdn_pin:0", "/fragment@28/__overlay__/sw_charger@6a:hl7005,cd_pin:0", "/fragment@29/__overlay__/speaker_amp@34:reset-gpio:0", "/fragment@29/__overlay__/speaker_amp@34:irq-gpio:0", "/fragment@30/__overlay__:interrupt-parent:0", "/fragment@31/__overlay__:interrupt-parent:0", "/fragment@31/__overlay__:deb-gpios:0", "/fragment@33/__overlay__:interrupt-parent:0", "/fragment@33/__overlay__:deb-gpios:0", "/fragment@34:target:0", "/fragment@37:target:0", "/fragment@38/__overlay__:interrupt-parent:0", "/fragment@46/__overlay__/alsps@51:interrupt-parent:0", "/fragment@57/__overlay__:GPIO_SIM2_SIO:0", "/fragment@57/__overlay__:GPIO_SIM2_SRST:0", "/fragment@57/__overlay__:GPIO_SIM2_SCLK:0", "/fragment@57/__overlay__:GPIO_SIM1_SCLK:0", "/fragment@57/__overlay__:GPIO_SIM1_SRST:0", "/fragment@57/__overlay__:GPIO_SIM1_SIO:0", "/fragment@57/__overlay__:GPIO_SIM2_HOT_PLUG:0", "/fragment@57/__overlay__:GPIO_SIM1_HOT_PLUG:0", "/fragment@59/__overlay__:interrupt-parent:0", "/fragment@60/__overlay__:interrupt-parent:0", "/fragment@61/__overlay__:interrupt-parent:0", "/fragment@62/__overlay__:interrupt-parent:0", "/fragment@62/__overlay__:deb-gpios:0", "/fragment@63/__overlay__:interrupt-parent:0", "/fragment@64/__overlay__:interrupt-parent:0", "/fragment@64/__overlay__:deb-gpios:0", "/fragment@65/__overlay__:interrupt-parent:0", "/fragment@66/__overlay__:interrupt-parent:0", "/fragment@67/__overlay__:interrupt-parent:0", "/fragment@68/__overlay__:interrupt-parent:0", "/fragment@69/__overlay__:interrupt-parent:0", "/fragment@82:target:0";
		pmic_clock_buffer_ctrl = "/fragment@44:target:0";
		rt9465_slave_chr = "/fragment@67:target:0";
		scp = "/fragment@2:target:0";
		smart_pa = "/fragment@69:target:0";
		spi0 = "/fragment@17:target:0";
		subpmic_pmu_eint = "/fragment@63:target:0";
		tcpc_pd = "/fragment@65:target:0";
		touch = "/fragment@3:target:0", "/fragment@30:target:0", "/fragment@59:target:0", "/fragment@80:target:0";
	};

	__local_fixups__ {

		fragment@1 {

			__overlay__ {

				usb_c_pinctrl {
					pinctrl-0 = <0x0>;
					pinctrl-1 = <0x0>;
					pinctrl-10 = <0x0>;
					pinctrl-11 = <0x0>;
					pinctrl-12 = <0x0>;
					pinctrl-2 = <0x0>;
					pinctrl-3 = <0x0>;
					pinctrl-4 = <0x0>;
					pinctrl-5 = <0x0>;
					pinctrl-6 = <0x0>;
					pinctrl-7 = <0x0>;
					pinctrl-8 = <0x0>;
					pinctrl-9 = <0x0>;
				};
			};
		};

		fragment@10 {

			__overlay__ {
				pinctrl-0 = <0x0>;
				pinctrl-1 = <0x0>;
			};
		};

		fragment@18 {

			__overlay__ {
				pinctrl-0 = <0x0>;
				pinctrl-1 = <0x0>;
				pinctrl-10 = <0x0>;
				pinctrl-11 = <0x0>;
				pinctrl-12 = <0x0>;
				pinctrl-13 = <0x0>;
				pinctrl-2 = <0x0>;
				pinctrl-3 = <0x0>;
				pinctrl-4 = <0x0>;
				pinctrl-5 = <0x0>;
				pinctrl-6 = <0x0>;
				pinctrl-7 = <0x0>;
				pinctrl-8 = <0x0>;
				pinctrl-9 = <0x0>;
			};
		};

		fragment@21 {

			__overlay__ {
				pinctrl-0 = <0x0>;
				pinctrl-1 = <0x0>;
				pinctrl-2 = <0x0>;
			};
		};

		fragment@24 {

			__overlay__ {

				i2c_lcd_bias@3e {
					pinctrl-0 = <0x0>;
					pinctrl-1 = <0x0>;
					pinctrl-2 = <0x0>;
					pinctrl-3 = <0x0>;
					pinctrl-4 = <0x0>;
				};
			};
		};

		fragment@3 {

			__overlay__ {
				pinctrl-0 = <0x0>;
				pinctrl-1 = <0x0>;
				pinctrl-2 = <0x0>;
				pinctrl-3 = <0x0>;
				pinctrl-4 = <0x0>;
				pinctrl-5 = <0x0>;
			};
		};

		fragment@35 {

			__overlay__ {
				pinctrl-0 = <0x0>;
				pinctrl-1 = <0x0>;
			};
		};

		fragment@38 {

			__overlay__ {
				pinctrl-0 = <0x0>;
				pinctrl-1 = <0x0>;
			};
		};

		fragment@6 {

			__overlay__ {
				pinctrl-0 = <0x0>;
				pinctrl-1 = <0x0>;
				pinctrl-10 = <0x0>;
				pinctrl-11 = <0x0>;
				pinctrl-2 = <0x0>;
				pinctrl-3 = <0x0>;
				pinctrl-4 = <0x0>;
				pinctrl-5 = <0x0>;
				pinctrl-6 = <0x0>;
				pinctrl-7 = <0x0>;
				pinctrl-8 = <0x0>;
				pinctrl-9 = <0x0>;
			};
		};

		fragment@83 {

			__overlay__ {
				pinctrl-0 = <0x0>;
				pinctrl-1 = <0x0>;
				pinctrl-10 = <0x0>;
				pinctrl-11 = <0x0>;
				pinctrl-12 = <0x0>;
				pinctrl-13 = <0x0>;
				pinctrl-14 = <0x0>;
				pinctrl-15 = <0x0>;
				pinctrl-16 = <0x0>;
				pinctrl-17 = <0x0>;
				pinctrl-18 = <0x0>;
				pinctrl-19 = <0x0>;
				pinctrl-2 = <0x0>;
				pinctrl-20 = <0x0>;
				pinctrl-21 = <0x0>;
				pinctrl-22 = <0x0>;
				pinctrl-23 = <0x0>;
				pinctrl-24 = <0x0>;
				pinctrl-25 = <0x0>;
				pinctrl-26 = <0x0>;
				pinctrl-27 = <0x0>;
				pinctrl-28 = <0x0>;
				pinctrl-29 = <0x0>;
				pinctrl-3 = <0x0>;
				pinctrl-30 = <0x0>;
				pinctrl-31 = <0x0>;
				pinctrl-32 = <0x0>;
				pinctrl-33 = <0x0>;
				pinctrl-34 = <0x0>;
				pinctrl-35 = <0x0>;
				pinctrl-36 = <0x0>;
				pinctrl-37 = <0x0>;
				pinctrl-38 = <0x0>;
				pinctrl-39 = <0x0>;
				pinctrl-4 = <0x0>;
				pinctrl-40 = <0x0>;
				pinctrl-41 = <0x0>;
				pinctrl-42 = <0x0>;
				pinctrl-43 = <0x0>;
				pinctrl-44 = <0x0>;
				pinctrl-45 = <0x0>;
				pinctrl-46 = <0x0>;
				pinctrl-47 = <0x0>;
				pinctrl-48 = <0x0>;
				pinctrl-49 = <0x0>;
				pinctrl-5 = <0x0>;
				pinctrl-50 = <0x0>;
				pinctrl-51 = <0x0>;
				pinctrl-52 = <0x0>;
				pinctrl-53 = <0x0>;
				pinctrl-54 = <0x0>;
				pinctrl-55 = <0x0>;
				pinctrl-56 = <0x0>;
				pinctrl-6 = <0x0>;
				pinctrl-7 = <0x0>;
				pinctrl-8 = <0x0>;
				pinctrl-9 = <0x0>;
			};
		};

		fragment@9 {

			__overlay__ {
				pinctrl-0 = <0x0>;
				pinctrl-1 = <0x0>;
				pinctrl-2 = <0x0>;
				pinctrl-3 = <0x0>;
				pinctrl-4 = <0x0>;
				pinctrl-5 = <0x0>;
				pinctrl-6 = <0x0>;
			};
		};
	};

	__symbols__ {
		accdet_pins_default = "/fragment@34/__overlay__/accdetdefault";
		accdet_pins_eint_as_int = "/fragment@34/__overlay__/accdeteint@0";
		alsps_mtk = "/fragment@46/__overlay__/alsps@51";
		aud_clk_mosi_off = "/fragment@7/__overlay__/aud_clk_mosi_off";
		aud_clk_mosi_on = "/fragment@7/__overlay__/aud_clk_mosi_on";
		aud_dat_miso_off = "/fragment@7/__overlay__/aud_dat_miso_off";
		aud_dat_miso_on = "/fragment@7/__overlay__/aud_dat_miso_on";
		aud_dat_mosi_off = "/fragment@7/__overlay__/aud_dat_mosi_off";
		aud_dat_mosi_on = "/fragment@7/__overlay__/aud_dat_mosi_on";
		aud_pins_smartpa_off = "/fragment@7/__overlay__/aud_pins_smartpa_off";
		aud_pins_smartpa_on = "/fragment@7/__overlay__/aud_pins_smartpa_on";
		barometer_mtk = "/fragment@46/__overlay__/barometer@77";
		cam_mipi_switch_en_0 = "/fragment@82/__overlay__/cam_mipi_switch_en_0";
		cam_mipi_switch_en_1 = "/fragment@82/__overlay__/cam_mipi_switch_en_1";
		cam_mipi_switch_sel_0 = "/fragment@82/__overlay__/cam_mipi_switch_sel_0";
		cam_mipi_switch_sel_1 = "/fragment@82/__overlay__/cam_mipi_switch_sel_1";
		camera_main_af_mtk = "/fragment@47/__overlay__/camera_main_af@72";
		camera_main_eeprom_mtk = "/fragment@47/__overlay__/camera_main_eeprom@50";
		camera_main_mtk = "/fragment@47/__overlay__/camera_main@1a";
		camera_main_two_af_mtk = "/fragment@49/__overlay__/camera_main_two_af@72";
		camera_main_two_eeprom_mtk = "/fragment@49/__overlay__/camera_main_two_eeprom@51";
		camera_main_two_mtk = "/fragment@49/__overlay__/camera_main_two@10";
		camera_pins_cam0_mclk_2ma = "/fragment@82/__overlay__/camera_pins_cam0_mclk_2ma";
		camera_pins_cam0_mclk_4ma = "/fragment@82/__overlay__/camera_pins_cam0_mclk_4ma";
		camera_pins_cam0_mclk_6ma = "/fragment@82/__overlay__/camera_pins_cam0_mclk_6ma";
		camera_pins_cam0_mclk_8ma = "/fragment@82/__overlay__/camera_pins_cam0_mclk_8ma";
		camera_pins_cam0_mclk_off = "/fragment@82/__overlay__/camera_pins_cam0_mclk_off";
		camera_pins_cam0_pnd_0 = "/fragment@82/__overlay__/cam0@2";
		camera_pins_cam0_pnd_1 = "/fragment@82/__overlay__/cam0@3";
		camera_pins_cam0_rst_0 = "/fragment@82/__overlay__/cam0@0";
		camera_pins_cam0_rst_1 = "/fragment@82/__overlay__/cam0@1";
		camera_pins_cam0_vcama_0 = "/fragment@82/__overlay__/cam0@vcam2";
		camera_pins_cam0_vcama_1 = "/fragment@82/__overlay__/cam0@vcam3";
		camera_pins_cam0_vcamd_0 = "/fragment@82/__overlay__/cam0@vcam0";
		camera_pins_cam0_vcamd_1 = "/fragment@82/__overlay__/cam0@vcam1";
		camera_pins_cam1_mclk_2ma = "/fragment@82/__overlay__/camera_pins_cam1_mclk_2ma";
		camera_pins_cam1_mclk_4ma = "/fragment@82/__overlay__/camera_pins_cam1_mclk_4ma";
		camera_pins_cam1_mclk_6ma = "/fragment@82/__overlay__/camera_pins_cam1_mclk_6ma";
		camera_pins_cam1_mclk_8ma = "/fragment@82/__overlay__/camera_pins_cam1_mclk_8ma";
		camera_pins_cam1_mclk_off = "/fragment@82/__overlay__/camera_pins_cam1_mclk_off";
		camera_pins_cam1_pnd_0 = "/fragment@82/__overlay__/cam1@2";
		camera_pins_cam1_pnd_1 = "/fragment@82/__overlay__/cam1@3";
		camera_pins_cam1_rst_0 = "/fragment@82/__overlay__/cam1@0";
		camera_pins_cam1_rst_1 = "/fragment@82/__overlay__/cam1@1";
		camera_pins_cam1_vcama_0 = "/fragment@82/__overlay__/cam1@vcam0";
		camera_pins_cam1_vcama_1 = "/fragment@82/__overlay__/cam1@vcam1";
		camera_pins_cam1_vcamd_0 = "/fragment@82/__overlay__/cam1@vcam4";
		camera_pins_cam1_vcamd_1 = "/fragment@82/__overlay__/cam1@vcam5";
		camera_pins_cam2_mclk_2ma = "/fragment@82/__overlay__/camera_pins_cam2_mclk_2ma";
		camera_pins_cam2_mclk_4ma = "/fragment@82/__overlay__/camera_pins_cam2_mclk_4ma";
		camera_pins_cam2_mclk_6ma = "/fragment@82/__overlay__/camera_pins_cam2_mclk_6ma";
		camera_pins_cam2_mclk_8ma = "/fragment@82/__overlay__/camera_pins_cam2_mclk_8ma";
		camera_pins_cam2_mclk_off = "/fragment@82/__overlay__/camera_pins_cam2_mclk_off";
		camera_pins_cam2_pnd_0 = "/fragment@82/__overlay__/cam2@3";
		camera_pins_cam2_pnd_1 = "/fragment@82/__overlay__/cam2@4";
		camera_pins_cam2_rst_0 = "/fragment@82/__overlay__/cam2@0";
		camera_pins_cam2_rst_1 = "/fragment@82/__overlay__/cam2@1";
		camera_pins_cam2_vcama_0 = "/fragment@82/__overlay__/cam1@vcam2";
		camera_pins_cam2_vcama_1 = "/fragment@82/__overlay__/cam1@vcam3";
		camera_pins_cam2_vcamd_0 = "/fragment@82/__overlay__/cam2@vcam0";
		camera_pins_cam2_vcamd_1 = "/fragment@82/__overlay__/cam2@vcam1";
		camera_pins_cam3_mclk_2ma = "/fragment@82/__overlay__/camera_pins_cam3_mclk_2ma";
		camera_pins_cam3_mclk_4ma = "/fragment@82/__overlay__/camera_pins_cam3_mclk_4ma";
		camera_pins_cam3_mclk_6ma = "/fragment@82/__overlay__/camera_pins_cam3_mclk_6ma";
		camera_pins_cam3_mclk_8ma = "/fragment@82/__overlay__/camera_pins_cam3_mclk_8ma";
		camera_pins_cam3_mclk_off = "/fragment@82/__overlay__/camera_pins_cam3_mclk_off";
		camera_pins_cam3_pnd_0 = "/fragment@82/__overlay__/cam3@2";
		camera_pins_cam3_pnd_1 = "/fragment@82/__overlay__/cam3@3";
		camera_pins_cam3_rst_0 = "/fragment@82/__overlay__/cam3@0";
		camera_pins_cam3_rst_1 = "/fragment@82/__overlay__/cam3@1";
		camera_pins_cam3_vcama_0 = "/fragment@82/__overlay__/cam3@vcam0";
		camera_pins_cam3_vcama_1 = "/fragment@82/__overlay__/cam3@vcam1";
		camera_pins_cam3_vcamd_0 = "/fragment@82/__overlay__/cam3@vcam2";
		camera_pins_cam3_vcamd_1 = "/fragment@82/__overlay__/cam3@vcam3";
		camera_pins_default = "/fragment@82/__overlay__/camdefault";
		camera_sub_eeprom_mtk = "/fragment@49/__overlay__/camera_sub_eeprom@54";
		camera_sub_mtk = "/fragment@49/__overlay__/camera_sub@35";
		camera_sub_two_af_mtk = "/fragment@47/__overlay__/camera_sub_two_af@0c";
		camera_sub_two_eeprom_mtk = "/fragment@47/__overlay__/camera_sub_two_eeprom@50";
		camera_sub_two_mtk = "/fragment@47/__overlay__/camera_sub_two@10";
		cap_touch_mtk = "/fragment@45/__overlay__/cap_touch@48";
		ccu_sensor_i2c_2_hw_mtk = "/fragment@47/__overlay__/ccu_sensor_i2c_2_hw@33";
		ccu_sensor_i2c_4_hw_mtk = "/fragment@49/__overlay__/ccu_sensor_i2c_4_hw@36";
		consys_pins_default = "/fragment@8/__overlay__/consys_default";
		ctp_pins_default = "/fragment@4/__overlay__/eint0default";
		ctp_pins_eint_as_int = "/fragment@4/__overlay__/eint@0";
		ctp_pins_eint_output0 = "/fragment@4/__overlay__/eintoutput0";
		ctp_pins_eint_output1 = "/fragment@4/__overlay__/eintoutput1";
		ctp_pins_rst_output0 = "/fragment@4/__overlay__/rstoutput0";
		ctp_pins_rst_output1 = "/fragment@4/__overlay__/rstoutput1";
		fingerprint = "/fragment@17/__overlay__/fingerprint@spi0";
		flashlights_aw3641_gpio = "/fragment@36/__overlay__/flashlight_aw3641_gpio";
		flashlights_isink = "/fragment@36/__overlay__/flashlight_isink";
		flashlights_sgm37898 = "/fragment@36/__overlay__/flashlights_sgm37898";
		flashlights_wd3100d_gpio = "/fragment@36/__overlay__/flashlight_wd3100d_gpio";
		fmlna_pins_init = "/fragment@8/__overlay__/fmlna@0";
		fmlna_pins_oh = "/fragment@8/__overlay__/fmlna@1";
		fmlna_pins_ol = "/fragment@8/__overlay__/fmlna@2";
		fpc_miso_pull_down = "/fragment@19/__overlay__/fpcmisolow";
		fpc_miso_pull_up = "/fragment@19/__overlay__/fpcmisoup";
		fpc_mode_as_ck = "/fragment@19/__overlay__/fpcck";
		fpc_mode_as_cs = "/fragment@19/__overlay__/fpccs";
		fpc_mode_as_mi = "/fragment@19/__overlay__/fpcmi";
		fpc_mode_as_mo = "/fragment@19/__overlay__/fpcmo";
		fpc_mosi_pull_down = "/fragment@19/__overlay__/fpcmosilow";
		fpc_mosi_pull_up = "/fragment@19/__overlay__/fpcmosiup";
		fpc_pins_default = "/fragment@19/__overlay__/fpcdefault";
		fpc_pins_eint_as_int = "/fragment@19/__overlay__/fpceint@0";
		fpc_pins_pwr_high = "/fragment@19/__overlay__/fpcpwrhigh";
		fpc_pins_pwr_low = "/fragment@19/__overlay__/fpcpwrlow";
		fpc_pins_rst_high = "/fragment@19/__overlay__/fpcrsthigh";
		fpc_pins_rst_low = "/fragment@19/__overlay__/fpcrstlow";
		gpio_redriver_c1_high = "/fragment@14/__overlay__/c1_high";
		gpio_redriver_c1_hiz = "/fragment@14/__overlay__/c1_highz";
		gpio_redriver_c1_init = "/fragment@14/__overlay__/c1_init";
		gpio_redriver_c1_low = "/fragment@14/__overlay__/c1_low";
		gpio_redriver_c2_high = "/fragment@14/__overlay__/c2_high";
		gpio_redriver_c2_hiz = "/fragment@14/__overlay__/c2_highz";
		gpio_redriver_c2_init = "/fragment@14/__overlay__/c2_init";
		gpio_redriver_c2_low = "/fragment@14/__overlay__/c2_low";
		gpio_u3_switch_disable = "/fragment@14/__overlay__/u3_sw_dis";
		gpio_u3_switch_enable = "/fragment@14/__overlay__/u3_sw_en";
		gpio_u3_switch_sel1 = "/fragment@14/__overlay__/u3_sw_sel1";
		gpio_u3_switch_sel2 = "/fragment@14/__overlay__/u3_sw_sel2";
		gpslna_pins_init = "/fragment@8/__overlay__/gpslna@0";
		gpslna_pins_oh = "/fragment@8/__overlay__/gpslna@1";
		gpslna_pins_ol = "/fragment@8/__overlay__/gpslna@2";
		i2c_lcd_bias_mtk = "/fragment@24/__overlay__/i2c_lcd_bias@3e";
		iddig_default = "/fragment@37/__overlay__/iddig_default";
		iddig_init = "/fragment@37/__overlay__/iddig_init";
		irtx_gpio_led_default = "/fragment@11/__overlay__/irtx_gpio_led_def@gpio90";
		irtx_gpio_led_set = "/fragment@11/__overlay__/irtx_gpio_led_set@gpio90";
		lcd_bias_pins_default = "/fragment@23/__overlay__/default";
		lcd_bias_pins_enn0 = "/fragment@23/__overlay__/lcdbias_enn_low";
		lcd_bias_pins_enn1 = "/fragment@23/__overlay__/lcdbias_enn_high";
		lcd_bias_pins_enp0 = "/fragment@23/__overlay__/lcdbias_enp_low";
		lcd_bias_pins_enp1 = "/fragment@23/__overlay__/lcdbias_enp_high";
		lcm_power_gpio = "/fragment@22/__overlay__/lcm_power_gpio";
		led0 = "/fragment@1/__overlay__/led@0";
		led1 = "/fragment@1/__overlay__/led@1";
		led2 = "/fragment@1/__overlay__/led@2";
		led3 = "/fragment@1/__overlay__/led@3";
		led4 = "/fragment@1/__overlay__/led@4";
		led5 = "/fragment@1/__overlay__/led@5";
		led6 = "/fragment@1/__overlay__/led@6";
		msensor_mtk = "/fragment@46/__overlay__/msensor@0c";
		mtkfb_pins_lcm_dsi_te = "/fragment@20/__overlay__/lcm_dsi_te";
		mtkfb_pins_lcm_reset0 = "/fragment@20/__overlay__/lcm_rst_out0_gpio";
		mtkfb_pins_lcm_reset1 = "/fragment@20/__overlay__/lcm_rst_out1_gpio";
		nfc_mtk = "/fragment@48/__overlay__/nfc@08";
		slave_charger_mtk = "/fragment@51/__overlay__/slave_charger@4b";
		speaker_amp_mtk = "/fragment@29/__overlay__/speaker_amp@34";
		subpmic_pmu_mtk = "/fragment@50/__overlay__/subpmic_pmu@34";
		sw_charger_mtk = "/fragment@28/__overlay__/sw_charger@6a";
		usb_c_pinctrl = "/fragment@1/__overlay__/usb_c_pinctrl";
		usb_default = "/fragment@14/__overlay__/usb_default";
		usb_type_c_mtk = "/fragment@50/__overlay__/usb_type_c@4e";
		vibrator0 = "/fragment@1/__overlay__/vibrator@0";
		vow_clk_miso_off = "/fragment@7/__overlay__/vow_clk_miso_off";
		vow_clk_miso_on = "/fragment@7/__overlay__/vow_clk_miso_on";
		vow_dat_miso_off = "/fragment@7/__overlay__/vow_dat_miso_off";
		vow_dat_miso_on = "/fragment@7/__overlay__/vow_dat_miso_on";
	};

	fragment@0 {
		target = <0xffffffff>;

		__overlay__ {
			atag,videolfb-fb_base_h = <0x0>;
			atag,videolfb-fb_base_l = "^`P";
			atag,videolfb-fps = <0x1770>;
			atag,videolfb-islcm_inited = <0x0>;
			atag,videolfb-islcmfound = <0x1>;
			atag,videolfb-lcmname = "nt35595_fhd_dsi_cmd_truly_nt50358_drv";
			atag,videolfb-vramSize = <0x17bb000>;
		};
	};

	fragment@1 {
		target = <0xffffffff>;

		__overlay__ {

			led@0 {
				compatible = "mediatek,red";
				data = <0x1>;
				led_mode = <0x0>;
				phandle = <0x77>;
				pwm_config = <0x0 0x0 0x0 0x0 0x0>;
			};

			led@1 {
				compatible = "mediatek,green";
				data = <0x1>;
				led_mode = <0x0>;
				phandle = <0x78>;
				pwm_config = <0x0 0x0 0x0 0x0 0x0>;
			};

			led@2 {
				compatible = "mediatek,blue";
				data = <0x1>;
				led_mode = <0x0>;
				phandle = <0x79>;
				pwm_config = <0x0 0x0 0x0 0x0 0x0>;
			};

			led@3 {
				compatible = "mediatek,jogball-backlight";
				data = <0x1>;
				led_mode = <0x0>;
				phandle = <0x7a>;
				pwm_config = <0x0 0x0 0x0 0x0 0x0>;
			};

			led@4 {
				compatible = "mediatek,keyboard-backlight";
				data = <0x1>;
				led_mode = <0x0>;
				phandle = <0x7b>;
				pwm_config = <0x0 0x0 0x0 0x0 0x0>;
			};

			led@5 {
				compatible = "mediatek,button-backlight";
				data = <0x1>;
				led_mode = <0x0>;
				phandle = <0x7c>;
				pwm_config = <0x0 0x0 0x0 0x0 0x0>;
			};

			led@6 {
				compatible = "mediatek,lcd-backlight";
				data = <0x1>;
				led_mode = <0x5>;
				phandle = <0x7d>;
				pwm_config = <0x0 0x0 0x0 0x0 0x0>;
			};

			usb_c_pinctrl {
				compatible = "mediatek,usb_c_pinctrl";
				phandle = <0x7f>;
				pinctrl-0 = <0x1>;
				pinctrl-1 = <0x2>;
				pinctrl-10 = <0xb>;
				pinctrl-11 = <0xc>;
				pinctrl-12 = <0xd>;
				pinctrl-2 = <0x3>;
				pinctrl-3 = <0x4>;
				pinctrl-4 = <0x5>;
				pinctrl-5 = <0x6>;
				pinctrl-6 = <0x7>;
				pinctrl-7 = <0x8>;
				pinctrl-8 = <0x9>;
				pinctrl-9 = <0xa>;
				pinctrl-names = "usb_default", "redrv_c1_init", "redrv_c1_low", "redrv_c1_hiz", "redrv_c1_high", "redrv_c2_init", "redrv_c2_low", "redrv_c2_hiz", "redrv_c2_high", "switch_sel1", "switch_sel2", "switch_enable", "switch_disable";
				status = "okay";

				usb_switch-data {
					c1_pin_num = <0x12>;
					c1_pin_val = <0x2>;
					c2_pin_num = <0x11>;
					c2_pin_val = <0x1>;
					en_pin_num = <0x0>;
					en_pin_val = <0x0>;
					sel_pin_num = <0xb1>;
					sel_pin_val = <0x1>;
				};
			};

			vibrator@0 {
				compatible = "mediatek,vibrator";
				phandle = <0x7e>;
				vib_limit = <0x9>;
				vib_timer = <0x19>;
				vib_vol = <0x9>;
			};
		};
	};

	fragment@10 {
		target = <0xffffffff>;

		__overlay__ {
			pinctrl-0 = <0x27>;
			pinctrl-1 = <0x28>;
			pinctrl-names = "irtx_gpio_led_default", "irtx_gpio_led_set";
			status = "okay";
		};
	};

	fragment@11 {
		target = <0xffffffff>;

		__overlay__ {

			irtx_gpio_led_def@gpio90 {
				phandle = <0x27>;

				pins_cmd_dat {
					bias-disable;
					input-schmitt-enable = <0x0>;
					output-low;
					pinmux = <0x5a00>;
					slew-rate = <0x1>;
				};
			};

			irtx_gpio_led_set@gpio90 {
				phandle = <0x28>;

				pins_cmd_dat {
					output-high;
					pinmux = <0x5a01>;
					slew-rate = <0x1>;
				};
			};
		};
	};

	fragment@12 {
		target = <0xffffffff>;

		__overlay__ {
			mt6370,intr_gpio = <0xffffffff 0xa 0x0>;
			mt6370,intr_gpio_num = <0xa>;
		};
	};

	fragment@13 {
		target = <0xffffffff>;

		__overlay__ {
			mt6370pd,intr_gpio = <0xffffffff 0x29 0x0>;
			mt6370pd,intr_gpio_num = <0x29>;
		};
	};

	fragment@14 {
		target = <0xffffffff>;

		__overlay__ {

			c1_high {
				phandle = <0x5>;

				pins_cmd_dat {
					output-high;
					pinmux = <0x1200>;
					slew-rate = <0x1>;
				};
			};

			c1_highz {
				phandle = <0x4>;

				pins_cmd_dat {
					bias-disable;
					pinmux = <0x1200>;
					slew-rate = <0x0>;
				};
			};

			c1_init {
				phandle = <0x2>;

				pins_cmd_dat {
					output-low;
					pinmux = <0x1200>;
					slew-rate = <0x1>;
				};
			};

			c1_low {
				phandle = <0x3>;

				pins_cmd_dat {
					output-low;
					pinmux = <0x1200>;
					slew-rate = <0x1>;
				};
			};

			c2_high {
				phandle = <0x9>;

				pins_cmd_dat {
					output-high;
					pinmux = <0x1100>;
					slew-rate = <0x1>;
				};
			};

			c2_highz {
				phandle = <0x8>;

				pins_cmd_dat {
					bias-disable;
					pinmux = <0x1100>;
					slew-rate = <0x0>;
				};
			};

			c2_init {
				phandle = <0x6>;

				pins_cmd_dat {
					output-low;
					pinmux = <0x1100>;
					slew-rate = <0x1>;
				};
			};

			c2_low {
				phandle = <0x7>;

				pins_cmd_dat {
					output-low;
					pinmux = <0x1100>;
					slew-rate = <0x1>;
				};
			};

			u3_sw_dis {
				phandle = <0xd>;
			};

			u3_sw_en {
				phandle = <0xc>;
			};

			u3_sw_sel1 {
				phandle = <0xa>;

				pins_cmd_dat {
					output-low;
					pinmux = <0xb100>;
					slew-rate = <0x1>;
				};
			};

			u3_sw_sel2 {
				phandle = <0xb>;

				pins_cmd_dat {
					output-high;
					pinmux = <0xb100>;
					slew-rate = <0x1>;
				};
			};

			usb_default {
				phandle = <0x1>;
			};
		};
	};

	fragment@15 {
		target = <0xffffffff>;

		__overlay__ {

			spc@40 {
				compatible = "prize,dcam_r";
				pdn_pin = <0xffffffff 0x6b 0x0>;
				reg = <0x3c>;
				rst_pin = <0xffffffff 0x6d 0x0>;
				sensor_type = <0x17f5>;
			};
		};
	};

	fragment@16 {
		target = <0xffffffff>;

		__overlay__ {

			rt9465@4b {
				charger_name = "secondary_chg";
				compatible = "richtek,rt9465";
				cv = <0x456d70>;
				en_st;
				en_wdt;
				ichg = <0x16e360>;
				ieoc = <0xaae60>;
				interrupt-names = "wdtmri";
				mivr = <0x44aa20>;
				reg = <0x4b>;
				rt,en_gpio = <0xffffffff 0xb3 0x0>;
				rt,en_gpio_num = <0xb3>;
				rt,intr_gpio = <0xffffffff 0x9 0x0>;
				rt,intr_gpio_num = <0x9>;
				safety_timer = <0xc>;
				status = "okay";
			};
		};
	};

	fragment@17 {
		target = <0xffffffff>;

		__overlay__ {
			#address-cells = <0x1>;
			#size-cells = <0x0>;

			fingerprint@spi0 {
				compatible = "focaltech,fingerprint-spidev";
				phandle = <0x80>;
				reg = <0x0>;
				spi-max-frequency = <0xf4240>;
				status = "okay";
			};
		};
	};

	fragment@18 {
		target = <0xffffffff>;

		__overlay__ {
			interrupt-parent = <0xffffffff>;
			interrupts = <0x0 0x2 0x0 0x0>;
			pinctrl-0 = <0x29>;
			pinctrl-1 = <0x2a>;
			pinctrl-10 = <0x33>;
			pinctrl-11 = <0x34>;
			pinctrl-12 = <0x35>;
			pinctrl-13 = <0x36>;
			pinctrl-2 = <0x2b>;
			pinctrl-3 = <0x2c>;
			pinctrl-4 = <0x2d>;
			pinctrl-5 = <0x2e>;
			pinctrl-6 = <0x2f>;
			pinctrl-7 = <0x30>;
			pinctrl-8 = <0x31>;
			pinctrl-9 = <0x32>;
			pinctrl-names = "default", "fpc_eint_as_int", "fpc_pins_rst_high", "fpc_pins_rst_low", "fpc_pins_pwr_high", "fpc_pins_pwr_low", "fpc_mode_as_cs", "fpc_mode_as_ck", "fpc_mode_as_mi", "fpc_mode_as_mo", "fpc_miso_pull_up", "fpc_miso_pull_down", "fpc_mosi_pull_up", "fpc_mosi_pull_down";
			status = "okay";
		};
	};

	fragment@19 {
		target = <0xffffffff>;

		__overlay__ {

			fpcck {
				phandle = <0x30>;

				pins_cmd_dat {
					bias-pull-up = <0x0>;
					pinmux = <0x5801>;
				};
			};

			fpccs {
				phandle = <0x2f>;

				pins_cmd_dat {
					bias-pull-up = <0x0>;
					pinmux = <0x5601>;
				};
			};

			fpcdefault {
				phandle = <0x29>;
			};

			fpceint@0 {
				phandle = <0x2a>;

				pins_cmd_dat {
					bias-disable;
					pinmux = <0x0>;
					slew-rate = <0x0>;
				};
			};

			fpcmi {
				phandle = <0x31>;

				pins_cmd_dat {
					bias-pull-up = <0x0>;
					pinmux = <0x5501>;
				};
			};

			fpcmisolow {
				phandle = <0x34>;

				pins_cmd_dat {
					output-low;
					pinmux = <0x5500>;
					slew-rate = <0x1>;
				};
			};

			fpcmisoup {
				phandle = <0x33>;

				pins_cmd_dat {
					output-high;
					pinmux = <0x5500>;
					slew-rate = <0x1>;
				};
			};

			fpcmo {
				phandle = <0x32>;

				pins_cmd_dat {
					bias-pull-down = <0x0>;
					pinmux = <0x5701>;
				};
			};

			fpcmosilow {
				phandle = <0x36>;

				pins_cmd_dat {
					output-low;
					pinmux = <0x5700>;
					slew-rate = <0x1>;
				};
			};

			fpcmosiup {
				phandle = <0x35>;

				pins_cmd_dat {
					output-high;
					pinmux = <0x5700>;
					slew-rate = <0x1>;
				};
			};

			fpcpwrhigh {
				phandle = <0x2d>;

				pins_cmd_dat {
					output-high;
					pinmux = <0x5000>;
					slew-rate = <0x1>;
				};
			};

			fpcpwrlow {
				phandle = <0x2e>;

				pins_cmd_dat {
					output-low;
					pinmux = <0x5000>;
					slew-rate = <0x1>;
				};
			};

			fpcrsthigh {
				phandle = <0x2b>;

				pins_cmd_dat {
					output-high;
					pinmux = <0xaf00>;
					slew-rate = <0x1>;
				};
			};

			fpcrstlow {
				phandle = <0x2c>;

				pins_cmd_dat {
					output-low;
					pinmux = <0xaf00>;
					slew-rate = <0x1>;
				};
			};
		};
	};

	fragment@2 {
		target = <0xffffffff>;

		__overlay__ {
			core_1 = "enable";
			scp_sramSize = <0x80000>;
		};
	};

	fragment@20 {
		target = <0xffffffff>;

		__overlay__ {

			lcm_dsi_te {
				phandle = <0x37>;

				pins_cmd_dat {
					pinmux = <0x2c01>;
				};
			};

			lcm_rst_out0_gpio {
				phandle = <0x38>;

				pins_cmd_dat {
					output-low;
					pinmux = <0x2d00>;
					slew-rate = <0x1>;
				};
			};

			lcm_rst_out1_gpio {
				phandle = <0x39>;

				pins_cmd_dat {
					output-high;
					pinmux = <0x2d00>;
					slew-rate = <0x1>;
				};
			};
		};
	};

	fragment@21 {
		target = <0xffffffff>;

		__overlay__ {
			pinctrl-0 = <0x37>;
			pinctrl-1 = <0x38>;
			pinctrl-2 = <0x39>;
			pinctrl-names = "mode_te_te", "lcm_rst_out0_gpio", "lcm_rst_out1_gpio";
			status = "okay";
		};
	};

	fragment@22 {
		target = <0xffffffff>;

		__overlay__ {

			lcm_power_gpio {
				compatible = "prize,lcm_power_gpio";
				gpio_lcd_bias_enn_gpio = <0xffffffff 0xa5 0x0>;
				gpio_lcd_bias_enn_pin = <0xa5>;
				gpio_lcd_bias_enp_gpio = <0xffffffff 0xb1 0x0>;
				gpio_lcd_bias_enp_pin = <0xb1>;
				gpio_lcd_ldo18_gpio = <0xffffffff 0x11 0x0>;
				gpio_lcd_ldo18_pin = <0x11>;
				gpio_lcd_reset_gpio = <0xffffffff 0x2d 0x0>;
				phandle = <0x81>;
			};
		};
	};

	fragment@23 {
		target = <0xffffffff>;

		__overlay__ {

			default {
				phandle = <0x3a>;
			};

			lcdbias_enn_high {
				phandle = <0x3d>;
			};

			lcdbias_enn_low {
				phandle = <0x3e>;
			};

			lcdbias_enp_high {
				phandle = <0x3b>;
			};

			lcdbias_enp_low {
				phandle = <0x3c>;
			};
		};
	};

	fragment@24 {
		target = <0xffffffff>;

		__overlay__ {

			i2c_lcd_bias@3e {
				compatible = "ti,tps65132";
				phandle = <0x82>;
				pinctrl-0 = <0x3a>;
				pinctrl-1 = <0x3b>;
				pinctrl-2 = <0x3c>;
				pinctrl-3 = <0x3d>;
				pinctrl-4 = <0x3e>;
				pinctrl-names = "default", "lcdbias_enp_high", "lcdbias_enp_low", "lcdbias_enn_high", "lcdbias_enn_low";
				reg = <0x3e>;
				status = "disable";
			};
		};
	};

	fragment@25 {
		target = <0xffffffff>;

		__overlay__ {

			fuelguage@62 {
				compatible = "cellwise,cw2015";
				reg = <0x62>;
				status = "okay";
			};
		};
	};

	fragment@26 {
		target = <0xffffffff>;

		__overlay__ {

			tcm_touch@2c {
				compatible = "synaptics,tcm-i2c";
				interrupt-parent = <0xffffffff>;
				interrupts = <0x1 0x2008>;
				reg = <0x2c>;
				synaptics,block-delay-us = <0x0>;
				synaptics,byte-delay-us = <0x0>;
				synaptics,display-reset-gpio = <0xffffffff 0x2d 0x0>;
				synaptics,irq-gpio = <0xffffffff 0x1 0x2008>;
				synaptics,irq-on-state = <0x0>;
				synaptics,power-delay-ms = <0xc8>;
				synaptics,reset-active-ms = <0x14>;
				synaptics,reset-delay-ms = <0xc8>;
				synaptics,reset-gpio = <0xffffffff 0x9e 0x0>;
				synaptics,reset-on-state = <0x0>;
				synaptics,ubl-byte-delay-us = <0x0>;
				synaptics,ubl-max-freq = <0x7a120>;
			};
		};
	};

	fragment@27 {
		target = <0xffffffff>;

		__overlay__ {

			exergen@44 {
				compatible = "exergen,fm78100";
				exergen_pdn_pin = <0xffffffff 0x47 0x0>;
				reg = <0x44>;
				status = "okay";
			};
		};
	};

	fragment@28 {
		target = <0xffffffff>;

		__overlay__ {

			spc@21 {
				compatible = "prize,spc_r";
				pdn_pin = <0xffffffff 0x6b 0x0>;
				reg = <0x21>;
				sensor_type = <0x310>;
			};

			sw_charger@6a {
				charger_name = "secondary_chg";
				compatible = "halo,hl7005";
				cv = <0x43e6d0>;
				gpio_swcharger_en_pin = <0x1c>;
				hl7005,cd_pin = <0xffffffff 0x1c 0x0>;
				ichg = <0x1e8480>;
				ieoc = <0x16e360>;
				mivr = <0x432380>;
				phandle = <0x83>;
				reg = <0x6a>;
				safety_timer = <0xc>;
				status = "okay";
			};

			wireless_chg_rx@2b {
				chipen-gpio = <0xffffffff 0x49 0x0>;
				compatible = "maxictech,mt5725";
				irq-gpio = <0xffffffff 0x48 0x0>;
				otgen-gpio = <0xffffffff 0x4a 0x0>;
				pwrst-gpio = <0xffffffff 0x4b 0x0>;
				reg = <0x2b>;
				status = "disable";
				trxset-gpio = <0xffffffff 0x67 0x0>;
			};
		};
	};

	fragment@29 {
		target = <0xffffffff>;

		__overlay__ {

			rt9465@4b {
				compatible = "richtek,rt9465";
				status = "disabled";
			};

			speaker_amp@34 {
				compatible = "mediatek,speaker_amp";
				irq-gpio = <0xffffffff 0xad 0x0>;
				phandle = <0x84>;
				reg = <0x34>;
				reset-gpio = <0xffffffff 0xb0 0x0>;
				status = "okay";
			};
		};
	};

	fragment@3 {
		target = <0xffffffff>;

		__overlay__ {
			pinctrl-0 = <0xe>;
			pinctrl-1 = <0xf>;
			pinctrl-2 = <0x10>;
			pinctrl-3 = <0x11>;
			pinctrl-4 = <0x12>;
			pinctrl-5 = <0x13>;
			pinctrl-names = "default", "state_eint_as_int", "state_eint_output0", "state_eint_output1", "state_rst_output0", "state_rst_output1";
			status = "okay";
			tpd-filter-custom-prameters = <0x0 0x0 0x0 0x0 0x0 0x0 0x0 0x0 0x0 0x0 0x0 0x0>;
			tpd-filter-custom-speed = <0x0 0x0 0x0>;
			tpd-filter-enable = <0x1>;
			tpd-filter-pixel-density = <0x92>;
			tpd-key-dim-local = <0x5a 0x373 0x64 0x28 0xe6 0x373 0x64 0x28 0x172 0x373 0x64 0x28 0x0 0x0 0x0 0x0>;
			tpd-key-local = <0x8b 0xac 0x9e 0x0>;
			tpd-key-num = <0x3>;
			tpd-max-touch-num = <0x5>;
			tpd-resolution = <0x438 0x924>;
			use-tpd-button = <0x0>;
		};
	};

	fragment@30 {
		target = <0xffffffff>;

		__overlay__ {
			interrupt-parent = <0xffffffff>;
			interrupts = <0x1 0x2 0x1 0x0>;
			status = "okay";
		};
	};

	fragment@31 {
		target = <0xffffffff>;

		__overlay__ {
			deb-gpios = <0xffffffff 0x12 0x0>;
			debounce = <0x3e800>;
			interrupt-parent = <0xffffffff>;
			interrupts = <0x12 0x8 0x12 0x0>;
			status = "okay";
		};
	};

	fragment@32 {
		target = <0xffffffff>;

		__overlay__ {

			bled {
				mt,max_bled_brightness = <0x2ad>;
			};

			ldo {
				compatible = "mediatek,mt6370_pmu_ldo";

				mt6370_ldo {
					regulator-name = "vtouch";
				};
			};

			rgbled {
				compatible = "mediatek,mt6370_pmu_rgbled";
				mt,led_default_trigger = "cc_mode", "cc_mode", "none", "cc_mode";
				mt,led_name = "green", "blue", "mt6360_pmu_led3", "red";
			};
		};
	};

	fragment@33 {
		target = <0xffffffff>;

		__overlay__ {
			deb-gpios = <0xffffffff 0x7 0x0>;
			debounce = <0x3e800>;
			interrupt-parent = <0xffffffff>;
			interrupts = <0x7 0x8 0x7 0x0>;
			status = "okay";
		};
	};

	fragment@34 {
		target = <0xffffffff>;

		__overlay__ {

			accdetdefault {
				phandle = <0x3f>;
			};

			accdeteint@0 {
				phandle = <0x40>;

				pins_cmd_dat {
					bias-disable;
					pinmux = <0x700>;
					slew-rate = <0x0>;
				};
			};
		};
	};

	fragment@35 {
		target = <0xffffffff>;

		__overlay__ {
			accdet-mic-mode = <0x1>;
			headset-three-key-threshold = <0x0 0x50 0xc8 0x190>;
			pinctrl-0 = <0x3f>;
			pinctrl-1 = <0x40>;
			pinctrl-names = "default", "state_eint_as_int";
		};
	};

	fragment@36 {
		target = <0xffffffff>;

		__overlay__ {

			flashlight_aw3641_gpio {
				compatible = "mediatek,flashlights_aw3641_gpio";
				phandle = <0x87>;
			};

			flashlight_isink {
				compatible = "mediatek,flashlights_isink";
				phandle = <0x86>;
			};

			flashlight_wd3100d_gpio {
				compatible = "mediatek,flashlights_wd3100d_gpio";
				phandle = <0x88>;
			};

			flashlights_sgm37898 {
				compatible = "mediatek,flashlights_sgm37898";
				phandle = <0x85>;
			};
		};
	};

	fragment@37 {
		target = <0xffffffff>;

		__overlay__ {

			iddig_default {
				phandle = <0x41>;
			};

			iddig_init {
				phandle = <0x42>;

				pins_cmd_dat {
					bias-pull-up = <0x0>;
					pinmux = <0x600>;
					slew-rate = <0x0>;
				};
			};
		};
	};

	fragment@38 {
		target = <0xffffffff>;

		__overlay__ {
			interrupt-parent = <0xffffffff>;
			interrupts = <0x6 0x8 0x6 0x0>;
			pinctrl-0 = <0x41>;
			pinctrl-1 = <0x42>;
			pinctrl-names = "iddig_default", "iddig_init";
		};
	};

	fragment@39 {
		target = <0xffffffff>;

		__overlay__ {
			ac_charger_current = <0x30d400>;
			ac_charger_input_current = <0x2dc6c0>;
		};
	};

	fragment@4 {
		target = <0xffffffff>;

		__overlay__ {

			eint0default {
				phandle = <0xe>;
			};

			eint@0 {
				phandle = <0xf>;

				pins_cmd_dat {
					bias-disable;
					pinmux = <0x100>;
					slew-rate = <0x0>;
				};
			};

			eintoutput0 {
				phandle = <0x10>;

				pins_cmd_dat {
					output-low;
					pinmux = <0x100>;
					slew-rate = <0x1>;
				};
			};

			eintoutput1 {
				phandle = <0x11>;

				pins_cmd_dat {
					output-high;
					pinmux = <0x100>;
					slew-rate = <0x1>;
				};
			};

			rstoutput0 {
				phandle = <0x12>;

				pins_cmd_dat {
					output-low;
					pinmux = <0x9e00>;
					slew-rate = <0x1>;
				};
			};

			rstoutput1 {
				phandle = <0x13>;

				pins_cmd_dat {
					output-high;
					pinmux = <0x9e00>;
					slew-rate = <0x1>;
				};
			};
		};
	};

	fragment@40 {
		target = <0xffffffff>;

		__overlay__ {
			battery_cv = <0x432380>;
			max_charge_temp = <0x37>;
			max_charge_temp_minus_x_degree = <0x32>;
			min_charge_temp = <0xfffffffb>;
			min_charge_temp_plus_x_degree = <0x0>;
		};
	};

	fragment@41 {
		target = <0xffffffff>;

		__overlay__ {

			led@6 {
				compatible = "mediatek,lcd-backlight";
				pwm_config = <0x0 0x3 0x0 0x0 0x0>;
			};
		};
	};

	fragment@42 {
		target = <0xffffffff>;

		__overlay__ {

			adc_channel@ {
				compatible = "mediatek,adc_channel";
				mediatek,adc_fdd_rf_params_dynamic_custom_ch = <0x2>;
				mediatek,temperature0 = <0x0>;
				mediatek,temperature1 = <0x1>;
				status = "okay";
			};
		};
	};

	fragment@43 {
		target = <0xffffffff>;

		__overlay__ {
			io-channels = <0xffffffff 0x2>;
		};
	};

	fragment@44 {
		target = <0xffffffff>;

		__overlay__ {
			mediatek,clkbuf-config = <0x2 0x1 0x1 0x2 0x0 0x0 0x1>;
			mediatek,clkbuf-driving-current = <0xffffffff 0xffffffff 0xffffffff 0xffffffff 0xffffffff 0xffffffff 0xffffffff>;
			mediatek,clkbuf-quantity = <0x7>;
			status = "okay";
		};
	};

	fragment@45 {
		target = <0xffffffff>;

		__overlay__ {
			#address-cells = <0x1>;
			#size-cells = <0x0>;
			clock-frequency = <0x61a80>;
			mediatek,use-open-drain;

			cap_touch@48 {
				compatible = "mediatek,cap_touch";
				phandle = <0x89>;
				reg = <0x48>;
				status = "okay";
			};
		};
	};

	fragment@46 {
		target = <0xffffffff>;

		__overlay__ {
			#address-cells = <0x1>;
			#size-cells = <0x0>;
			clock-frequency = <0x61a80>;
			mediatek,use-open-drain;

			alsps@51 {
				compatible = "mediatek,alsps";
				interrupt-parent = <0xffffffff>;
				interrupts = <0x6 0x8 0x6 0x0>;
				phandle = <0x8b>;
				reg = <0x51>;
				status = "okay";
			};

			barometer@77 {
				compatible = "mediatek,barometer";
				phandle = <0x8c>;
				reg = <0x77>;
				status = "okay";
			};

			msensor@0c {
				compatible = "mediatek,msensor";
				phandle = <0x8a>;
				reg = <0xc>;
				status = "okay";
			};
		};
	};

	fragment@47 {
		target = <0xffffffff>;

		__overlay__ {
			#address-cells = <0x1>;
			#size-cells = <0x0>;
			clock-frequency = <0x61a80>;
			mediatek,use-open-drain;

			camera_main@1a {
				compatible = "mediatek,camera_main";
				phandle = <0x8d>;
				reg = <0x1a>;
				status = "okay";
			};

			camera_main_af@72 {
				compatible = "mediatek,camera_main_af";
				phandle = <0x8e>;
				reg = <0x72>;
				status = "okay";
			};

			camera_main_eeprom@50 {
				compatible = "mediatek,camera_main_eeprom";
				phandle = <0x8f>;
				reg = <0x50>;
				status = "okay";
			};

			camera_sub_two@10 {
				compatible = "mediatek,camera_sub_two";
				phandle = <0x92>;
				reg = <0x10>;
				status = "okay";
			};

			camera_sub_two_af@0c {
				compatible = "mediatek,camera_sub_two_af";
				phandle = <0x90>;
				reg = <0xc>;
				status = "okay";
			};

			camera_sub_two_eeprom@50 {
				compatible = "mediatek,camera_sub_two_eeprom";
				phandle = <0x91>;
				reg = <0x50>;
				status = "okay";
			};

			ccu_sensor_i2c_2_hw@33 {
				compatible = "mediatek,ccu_sensor_i2c_2_hw";
				phandle = <0x93>;
				reg = <0x33>;
				status = "okay";
			};
		};
	};

	fragment@48 {
		target = <0xffffffff>;

		__overlay__ {
			#address-cells = <0x1>;
			#size-cells = <0x0>;
			clock-frequency = <0x61a80>;
			mediatek,use-open-drain;

			nfc@08 {
				compatible = "mediatek,nfc";
				phandle = <0x94>;
				reg = <0x8>;
				status = "okay";
			};
		};
	};

	fragment@49 {
		target = <0xffffffff>;

		__overlay__ {
			#address-cells = <0x1>;
			#size-cells = <0x0>;
			clock-frequency = <0x61a80>;
			mediatek,use-open-drain;

			camera_main_two@10 {
				compatible = "mediatek,camera_main_two";
				phandle = <0x95>;
				reg = <0x10>;
				status = "okay";
			};

			camera_main_two_af@72 {
				compatible = "mediatek,camera_main_two_af";
				phandle = <0x96>;
				reg = <0x72>;
				status = "okay";
			};

			camera_main_two_eeprom@51 {
				compatible = "mediatek,camera_main_two_eeprom";
				phandle = <0x97>;
				reg = <0x51>;
				status = "okay";
			};

			camera_sub@35 {
				compatible = "mediatek,camera_sub";
				phandle = <0x98>;
				reg = <0x35>;
				status = "okay";
			};

			camera_sub_eeprom@54 {
				compatible = "mediatek,camera_sub_eeprom";
				phandle = <0x99>;
				reg = <0x54>;
				status = "okay";
			};

			ccu_sensor_i2c_4_hw@36 {
				compatible = "mediatek,ccu_sensor_i2c_4_hw";
				phandle = <0x9a>;
				reg = <0x36>;
				status = "okay";
			};
		};
	};

	fragment@5 {
		target = <0xffffffff>;

		__overlay__ {
			accdet-mic-mode = <0x1>;
			accdet-mic-vol = <0x6>;
			accdet-plugout-debounce = <0x1>;
			headset-eint-level-pol = <0x8>;
			headset-four-key-threshold = <0x0 0x3a 0x79 0xc0 0x190>;
			headset-mode-setting = <0x500 0x500 0x1 0x1f0 0x800 0x800 0x20 0x44>;
			headset-three-key-threshold = <0x0 0x50 0xc8 0x190>;
			headset-three-key-threshold-CDD = <0x0 0x79 0xc0 0x258>;
			status = "okay";
		};
	};

	fragment@50 {
		target = <0xffffffff>;

		__overlay__ {
			#address-cells = <0x1>;
			#size-cells = <0x0>;
			clock-frequency = <0x33e140>;
			mediatek,use-push-pull;

			subpmic_pmu@34 {
				compatible = "mediatek,subpmic_pmu";
				phandle = <0x9c>;
				reg = <0x34>;
				status = "okay";
			};

			usb_type_c@4e {
				compatible = "mediatek,usb_type_c";
				phandle = <0x9b>;
				reg = <0x4e>;
				status = "okay";
			};
		};
	};

	fragment@51 {
		target = <0xffffffff>;

		__overlay__ {
			#address-cells = <0x1>;
			#size-cells = <0x0>;
			clock-frequency = <0x61a80>;
			mediatek,use-open-drain;

			slave_charger@4b {
				compatible = "mediatek,slave_charger";
				phandle = <0x9d>;
				reg = <0x4b>;
				status = "okay";
			};
		};
	};

	fragment@52 {
		target = <0xffffffff>;

		__overlay__ {
			#address-cells = <0x1>;
			#size-cells = <0x0>;
			clock-frequency = <0x61a80>;
			mediatek,use-open-drain;
		};
	};

	fragment@53 {
		target = <0xffffffff>;

		__overlay__ {
			#address-cells = <0x1>;
			#size-cells = <0x0>;
			clock-frequency = <0x61a80>;
			mediatek,use-open-drain;
		};
	};

	fragment@54 {
		target = <0xffffffff>;

		__overlay__ {
			#address-cells = <0x1>;
			#size-cells = <0x0>;
			clock-frequency = <0x61a80>;
			mediatek,use-open-drain;
		};
	};

	fragment@55 {
		target = <0xffffffff>;

		__overlay__ {
			#address-cells = <0x1>;
			#size-cells = <0x0>;
			clock-frequency = <0x61a80>;
			mediatek,use-open-drain;
		};
	};

	fragment@56 {
		target = <0xffffffff>;

		__overlay__ {
			#address-cells = <0x1>;
			#size-cells = <0x0>;
			clock-frequency = <0x61a80>;
			mediatek,use-open-drain;
		};
	};

	fragment@57 {
		target = <0xffffffff>;

		__overlay__ {
			GPIO_SIM1_HOT_PLUG = <0xffffffff 0x2f 0x0>;
			GPIO_SIM1_SCLK = <0xffffffff 0x26 0x0>;
			GPIO_SIM1_SIO = <0xffffffff 0x28 0x0>;
			GPIO_SIM1_SRST = <0xffffffff 0x27 0x0>;
			GPIO_SIM2_HOT_PLUG = <0xffffffff 0x2e 0x0>;
			GPIO_SIM2_SCLK = <0xffffffff 0x25 0x0>;
			GPIO_SIM2_SIO = <0xffffffff 0x23 0x0>;
			GPIO_SIM2_SRST = <0xffffffff 0x24 0x0>;
		};
	};

	fragment@58 {
		target = <0xffffffff>;

		__overlay__ {
			gpio_init_default = <0x0 0x0 0x0 0x0 0x1 0x1 0x1 0x1 0x0 0x0 0x0 0x1 0x1 0x1 0x2 0x0 0x0 0x0 0x1 0x0 0x1 0x3 0x0 0x0 0x0 0x1 0x0 0x1 0x4 0x0 0x0 0x0 0x1 0x0 0x0 0x5 0x0 0x0 0x0 0x1 0x1 0x0 0x6 0x0 0x0 0x0 0x1 0x1 0x0 0x7 0x0 0x0 0x0 0x1 0x1 0x0 0x8 0x7 0x0 0x0 0x1 0x1 0x0 0x9 0x0 0x0 0x0 0x1 0x0 0x0 0xa 0x0 0x0 0x0 0x1 0x1 0x0 0xb 0x3 0x0 0x0 0x1 0x1 0x0 0xc 0x3 0x0 0x0 0x1 0x1 0x0 0xd 0x2 0x0 0x0 0x1 0x0 0x0 0xe 0x0 0x0 0x0 0x1 0x0 0x0 0xf 0x2 0x1 0x0 0x1 0x0 0x0 0x10 0x2 0x1 0x0 0x0 0x0 0x0 0x11 0x0 0x0 0x0 0x1 0x0 0x0 0x12 0x0 0x0 0x0 0x1 0x1 0x0 0x13 0x0 0x1 0x1 0x0 0x0 0x0 0x14 0x0 0x0 0x0 0x1 0x0 0x0 0x15 0x4 0x0 0x0 0x1 0x0 0x0 0x16 0x4 0x0 0x0 0x1 0x0 0x0 0x17 0x0 0x0 0x0 0x1 0x0 0x0 0x18 0x5 0x0 0x0 0x1 0x0 0x0 0x19 0x0 0x1 0x0 0x0 0x0 0x0 0x1a 0x0 0x1 0x0 0x0 0x0 0x0 0x1b 0x5 0x1 0x0 0x0 0x0 0x0 0x1c 0x0 0x1 0x0 0x1 0x0 0x0 0x1d 0x1 0x1 0x0 0x0 0x0 0x0 0x1e 0x1 0x0 0x0 0x1 0x1 0x0 0x1f 0x1 0x0 0x0 0x1 0x1 0x0 0x20 0x1 0x0 0x0 0x1 0x1 0x0 0x21 0x1 0x0 0x0 0x1 0x1 0x0 0x22 0x1 0x0 0x0 0x1 0x1 0x0 0x23 0x1 0x0 0x0 0x1 0x1 0x0 0x24 0x1 0x1 0x0 0x0 0x0 0x0 0x25 0x1 0x1 0x0 0x0 0x0 0x0 0x26 0x1 0x1 0x0 0x0 0x0 0x0 0x27 0x1 0x1 0x0 0x0 0x0 0x0 0x28 0x1 0x0 0x0 0x1 0x1 0x0 0x29 0x0 0x0 0x0 0x1 0x1 0x0 0x2a 0x0 0x1 0x0 0x0 0x0 0x0 0x2b 0x1 0x1 0x0 0x0 0x0 0x0 0x2c 0x1 0x0 0x0 0x1 0x0 0x0 0x2d 0x0 0x1 0x0 0x0 0x0 0x0 0x2e 0x1 0x0 0x0 0x1 0x1 0x0 0x2f 0x1 0x0 0x0 0x1 0x1 0x0 0x30 0x1 0x0 0x0 0x1 0x1 0x0 0x31 0x1 0x0 0x0 0x1 0x1 0x0 0x32 0x1 0x0 0x0 0x1 0x1 0x0 0x33 0x1 0x0 0x0 0x1 0x1 0x0 0x34 0x1 0x1 0x0 0x1 0x0 0x0 0x35 0x1 0x1 0x0 0x1 0x0 0x0 0x36 0x1 0x1 0x0 0x1 0x0 0x0 0x37 0x1 0x1 0x0 0x1 0x0 0x0 0x38 0x1 0x1 0x0 0x1 0x0 0x0 0x39 0x1 0x1 0x0 0x1 0x0 0x0 0x3a 0x0 0x0 0x0 0x1 0x0 0x0 0x3b 0x1 0x0 0x0 0x1 0x0 0x0 0x3c 0x1 0x0 0x0 0x1 0x0 0x0 0x3d 0x1 0x0 0x0 0x1 0x0 0x0 0x3e 0x1 0x0 0x0 0x1 0x0 0x0 0x3f 0x1 0x0 0x0 0x1 0x0 0x0 0x40 0x1 0x0 0x0 0x1 0x0 0x0 0x41 0x2 0x0 0x0 0x1 0x0 0x0 0x42 0x2 0x0 0x0 0x1 0x0 0x0 0x43 0x1 0x0 0x0 0x1 0x0 0x0 0x44 0x1 0x0 0x0 0x1 0x0 0x0 0x45 0x0 0x0 0x0 0x1 0x1 0x0 0x46 0x1 0x1 0x0 0x1 0x0 0x0 0x47 0x1 0x1 0x0 0x1 0x0 0x0 0x48 0x1 0x1 0x0 0x1 0x0 0x0 0x49 0x1 0x1 0x0 0x1 0x0 0x0 0x4a 0x1 0x1 0x0 0x1 0x0 0x0 0x4b 0x1 0x1 0x0 0x1 0x0 0x0 0x4c 0x1 0x1 0x0 0x1 0x0 0x0 0x4d 0x1 0x1 0x0 0x1 0x0 0x0 0x4e 0x1 0x1 0x0 0x1 0x0 0x0 0x4f 0x0 0x1 0x0 0x1 0x0 0x0 0x50 0x1 0x0 0x0 0x1 0x0 0x0 0x51 0x1 0x0 0x0 0x1 0x1 0x0 0x52 0x1 0x0 0x0 0x1 0x1 0x0 0x53 0x1 0x0 0x0 0x1 0x1 0x0 0x54 0x1 0x0 0x0 0x1 0x1 0x0 0x55 0x1 0x1 0x0 0x0 0x0 0x0 0x56 0x1 0x0 0x0 0x1 0x0 0x0 0x57 0x1 0x0 0x0 0x1 0x0 0x0 0x58 0x1 0x0 0x0 0x1 0x0 0x0 0x59 0x1 0x0 0x0 0x1 0x0 0x0 0x5a 0x1 0x1 0x0 0x0 0x0 0x0 0x5b 0x0 0x1 0x0 0x0 0x0 0x0 0x5c 0x0 0x1 0x0 0x0 0x0 0x0 0x5d 0x1 0x0 0x0 0x1 0x1 0x0 0x5e 0x1 0x0 0x0 0x1 0x1 0x0 0x5f 0x1 0x0 0x0 0x1 0x1 0x0 0x60 0x1 0x1 0x0 0x0 0x0 0x0 0x61 0x0 0x1 0x0 0x0 0x0 0x0 0x62 0x0 0x1 0x0 0x0 0x0 0x0 0x63 0x0 0x1 0x0 0x0 0x0 0x0 0x64 0x0 0x1 0x0 0x0 0x0 0x0 0x65 0x0 0x1 0x0 0x0 0x0 0x0 0x66 0x0 0x1 0x0 0x0 0x0 0x0 0x67 0x1 0x0 0x0 0x1 0x1 0x0 0x68 0x1 0x0 0x0 0x1 0x1 0x0 0x69 0x1 0x0 0x0 0x1 0x1 0x0 0x6a 0x1 0x0 0x0 0x1 0x1 0x0 0x6b 0x0 0x1 0x0 0x0 0x0 0x0 0x6c 0x0 0x1 0x0 0x0 0x0 0x0 0x6d 0x0 0x1 0x0 0x0 0x0 0x0 0x6e 0x0 0x1 0x0 0x0 0x0 0x0 0x6f 0x0 0x0 0x0 0x0 0x0 0x0 0x70 0x0 0x1 0x0 0x0 0x0 0x0 0x71 0x0 0x0 0x0 0x1 0x0 0x0 0x72 0x0 0x0 0x0 0x1 0x0 0x0 0x73 0x0 0x0 0x0 0x1 0x0 0x0 0x74 0x0 0x0 0x0 0x1 0x0 0x0 0x75 0x0 0x0 0x0 0x1 0x0 0x0 0x76 0x0 0x0 0x0 0x1 0x0 0x0 0x77 0x0 0x0 0x0 0x1 0x0 0x0 0x78 0x0 0x0 0x0 0x1 0x0 0x0 0x79 0x0 0x0 0x0 0x1 0x0 0x0 0x7a 0x1 0x0 0x0 0x1 0x1 0x0 0x7b 0x1 0x0 0x0 0x1 0x1 0x0 0x7c 0x1 0x1 0x0 0x0 0x0 0x0 0x7d 0x1 0x0 0x0 0x1 0x1 0x0 0x7e 0x1 0x0 0x0 0x1 0x1 0x0 0x7f 0x1 0x0 0x0 0x1 0x1 0x0 0x80 0x1 0x0 0x0 0x1 0x1 0x0 0x81 0x1 0x0 0x0 0x1 0x1 0x0 0x82 0x1 0x0 0x0 0x1 0x1 0x0 0x83 0x1 0x0 0x0 0x1 0x0 0x0 0x84 0x1 0x0 0x0 0x1 0x1 0x0 0x85 0x1 0x1 0x1 0x0 0x0 0x0 0x86 0x1 0x0 0x0 0x1 0x0 0x1 0x87 0x1 0x1 0x0 0x0 0x0 0x0 0x88 0x1 0x1 0x0 0x1 0x0 0x0 0x89 0x1 0x1 0x0 0x1 0x0 0x0 0x8a 0x1 0x1 0x0 0x0 0x0 0x0 0x8b 0x1 0x1 0x0 0x1 0x0 0x0 0x8c 0x1 0x0 0x0 0x0 0x0 0x0 0x8d 0x1 0x0 0x0 0x0 0x0 0x0 0x8e 0x1 0x0 0x0 0x0 0x0 0x0 0x8f 0x1 0x0 0x0 0x0 0x0 0x0 0x90 0x1 0x0 0x0 0x1 0x0 0x0 0x91 0x1 0x1 0x1 0x0 0x0 0x0 0x92 0x1 0x0 0x0 0x1 0x0 0x0 0x93 0x1 0x1 0x0 0x0 0x0 0x0 0x94 0x1 0x1 0x0 0x0 0x0 0x0 0x95 0x1 0x1 0x0 0x0 0x0 0x0 0x96 0x0 0x1 0x0 0x0 0x0 0x0 0x97 0x0 0x1 0x0 0x0 0x0 0x0 0x98 0x0 0x1 0x0 0x0 0x0 0x0 0x99 0x0 0x1 0x0 0x0 0x0 0x0 0x9a 0x1 0x1 0x0 0x0 0x0 0x0 0x9b 0x1 0x0 0x0 0x1 0x0 0x0 0x9c 0x0 0x0 0x0 0x1 0x0 0x0 0x9d 0x0 0x0 0x0 0x1 0x0 0x0 0x9e 0x0 0x1 0x0 0x0 0x0 0x0 0x9f 0x0 0x1 0x0 0x1 0x1 0x0 0xa0 0x0 0x1 0x0 0x0 0x0 0x0 0xa1 0x2 0x0 0x0 0x1 0x0 0x0 0xa2 0x2 0x1 0x1 0x0 0x0 0x0 0xa3 0x2 0x1 0x0 0x0 0x0 0x0 0xa4 0x2 0x1 0x0 0x0 0x0 0x0 0xa5 0x0 0x1 0x1 0x0 0x0 0x0 0xa6 0x0 0x1 0x0 0x0 0x0 0x0 0xa7 0x1 0x1 0x0 0x1 0x0 0x0 0xa8 0x1 0x1 0x0 0x1 0x0 0x0 0xa9 0x0 0x1 0x0 0x0 0x0 0x0 0xaa 0x2 0x1 0x0 0x1 0x0 0x0 0xab 0x2 0x1 0x0 0x1 0x0 0x0 0xac 0x2 0x1 0x0 0x1 0x0 0x0 0xad 0x0 0x0 0x0 0x1 0x0 0x0 0xae 0x2 0x0 0x0 0x1 0x0 0x0 0xaf 0x0 0x0 0x0 0x0 0x0 0x0 0xb0 0x0 0x1 0x0 0x0 0x0 0x0 0xb1 0x0 0x1 0x0 0x0 0x0 0x0 0xb2 0x0 0x1 0x0 0x0 0x0 0x0 0xb3 0x0 0x0 0x0 0x1 0x0 0x0 0xb4 0x0 0x0 0x0 0x1 0x0 0x0 0xb5 0x0 0x0 0x0 0x1 0x0 0x0 0xb6 0x0 0x0 0x0 0x1 0x0 0x0 0xb7 0x0 0x0 0x0 0x1 0x0 0x0 0xb8 0x0 0x0 0x0 0x1 0x0 0x0 0xb9 0x0 0x0 0x0 0x1 0x0 0x0 0xba 0x0 0x0 0x0 0x1 0x0 0x0 0xbb 0x0 0x0 0x0 0x1 0x0 0x0 0xbc 0x0 0x0 0x0 0x1 0x0 0x0 0xbd 0x0 0x0 0x0 0x1 0x0 0x0 0xbe 0x0 0x0 0x0 0x1 0x0 0x0 0xbf 0x0 0x0 0x0 0x1 0x0 0x0>;
		};
	};

	fragment@59 {
		target = <0xffffffff>;

		__overlay__ {
			interrupt-parent = <0xffffffff>;
			interrupts = <0x1 0x2 0x1 0x0>;
			status = "okay";
		};
	};

	fragment@6 {
		target = <0xffffffff>;

		__overlay__ {
			pinctrl-0 = <0x14>;
			pinctrl-1 = <0x15>;
			pinctrl-10 = <0x1e>;
			pinctrl-11 = <0x1f>;
			pinctrl-2 = <0x16>;
			pinctrl-3 = <0x17>;
			pinctrl-4 = <0x18>;
			pinctrl-5 = <0x19>;
			pinctrl-6 = <0x1a>;
			pinctrl-7 = <0x1b>;
			pinctrl-8 = <0x1c>;
			pinctrl-9 = <0x1d>;
			pinctrl-names = "aud_clk_mosi_off", "aud_clk_mosi_on", "aud_dat_mosi_off", "aud_dat_mosi_on", "aud_dat_miso_off", "aud_dat_miso_on", "aud_smartpa_off", "aud_smartpa_on", "vow_dat_miso_off", "vow_dat_miso_on", "vow_clk_miso_off", "vow_clk_miso_on";
			status = "okay";
		};
	};

	fragment@60 {
		target = <0xffffffff>;

		__overlay__ {
			interrupt-parent = <0xffffffff>;
			interrupts = <0x3 0x4 0x3 0x0>;
			status = "okay";
		};
	};

	fragment@61 {
		target = <0xffffffff>;

		__overlay__ {
			interrupt-parent = <0xffffffff>;
			interrupts = <0x5 0x8 0x5 0x0>;
			status = "okay";
		};
	};

	fragment@62 {
		target = <0xffffffff>;

		__overlay__ {
			deb-gpios = <0xffffffff 0x7 0x0>;
			debounce = <0x3e800>;
			interrupt-parent = <0xffffffff>;
			interrupts = <0x7 0x8 0x7 0x0>;
			status = "okay";
		};
	};

	fragment@63 {
		target = <0xffffffff>;

		__overlay__ {
			interrupt-parent = <0xffffffff>;
			interrupts = <0xa 0x8 0xa 0x0>;
			status = "okay";
		};
	};

	fragment@64 {
		target = <0xffffffff>;

		__overlay__ {
			deb-gpios = <0xffffffff 0x12 0x0>;
			debounce = <0x3e800>;
			interrupt-parent = <0xffffffff>;
			interrupts = <0x12 0x8 0x12 0x0>;
			status = "okay";
		};
	};

	fragment@65 {
		target = <0xffffffff>;

		__overlay__ {
			interrupt-parent = <0xffffffff>;
			interrupts = <0x29 0x8 0x29 0x0>;
			status = "okay";
		};
	};

	fragment@66 {
		target = <0xffffffff>;

		__overlay__ {
			interrupt-parent = <0xffffffff>;
			interrupts = <0x2c 0x1 0x2c 0x1>;
			status = "okay";
		};
	};

	fragment@67 {
		target = <0xffffffff>;

		__overlay__ {
			interrupt-parent = <0xffffffff>;
			interrupts = <0x45 0x8 0x45 0x0>;
			status = "okay";
		};
	};

	fragment@68 {
		target = <0xffffffff>;

		__overlay__ {
			interrupt-parent = <0xffffffff>;
			interrupts = <0xb6 0x4 0xbe 0x0>;
			status = "okay";
		};
	};

	fragment@69 {
		target = <0xffffffff>;

		__overlay__ {
			interrupt-parent = <0xffffffff>;
			interrupts = <0xba 0x8 0xad 0x0>;
			status = "okay";
		};
	};

	fragment@7 {
		target = <0xffffffff>;

		__overlay__ {

			aud_clk_mosi_off {
				phandle = <0x14>;

				pins_cmd0_dat {
					bias-pull-down;
					input-enable;
					pinmux = <0x8800>;
				};

				pins_cmd1_dat {
					bias-pull-down;
					input-enable;
					pinmux = <0x8900>;
				};
			};

			aud_clk_mosi_on {
				phandle = <0x15>;

				pins_cmd0_dat {
					bias-disable;
					input-schmitt-enable;
					pinmux = <0x8801>;
				};

				pins_cmd1_dat {
					bias-disable;
					input-schmitt-enable;
					pinmux = <0x8901>;
				};
			};

			aud_dat_miso_off {
				phandle = <0x18>;

				pins_cmd0_dat {
					bias-disable;
					input-enable;
					pinmux = <0x8c00>;
				};

				pins_cmd1_dat {
					bias-disable;
					input-enable;
					pinmux = <0x8d00>;
				};

				pins_cmd2_dat {
					bias-disable;
					input-enable;
					pinmux = <0x8e00>;
				};

				pins_cmd3_dat {
					bias-disable;
					input-enable;
					pinmux = <0x8f00>;
				};
			};

			aud_dat_miso_on {
				phandle = <0x19>;

				pins_cmd0_dat {
					bias-disable;
					input-schmitt-enable;
					pinmux = <0x8c01>;
				};

				pins_cmd1_dat {
					bias-disable;
					input-schmitt-enable;
					pinmux = <0x8d01>;
				};

				pins_cmd2_dat {
					bias-disable;
					input-schmitt-enable;
					pinmux = <0x8e01>;
				};

				pins_cmd3_dat {
					bias-disable;
					input-schmitt-enable;
					pinmux = <0x8f01>;
				};
			};

			aud_dat_mosi_off {
				phandle = <0x16>;

				pins_cmd0_dat {
					bias-disable;
					input-enable;
					pinmux = <0x8a00>;
				};

				pins_cmd1_dat {
					bias-pull-down;
					input-enable;
					pinmux = <0x8b00>;
				};
			};

			aud_dat_mosi_on {
				phandle = <0x17>;

				pins_cmd0_dat {
					bias-disable;
					input-schmitt-enable;
					pinmux = <0x8a01>;
				};

				pins_cmd1_dat {
					bias-disable;
					input-schmitt-enable;
					pinmux = <0x8b01>;
				};
			};

			aud_pins_smartpa_off {
				phandle = <0x1a>;

				pins_cmd0_dat {
					pinmux = <0xae00>;
				};

				pins_cmd1_dat {
					pinmux = <0xaa00>;
				};

				pins_cmd2_dat {
					pinmux = <0xab00>;
				};

				pins_cmd3_dat {
					pinmux = <0xac00>;
				};
			};

			aud_pins_smartpa_on {
				phandle = <0x1b>;

				pins_cmd0_dat {
					pinmux = <0xae02>;
				};

				pins_cmd1_dat {
					pinmux = <0xaa02>;
				};

				pins_cmd2_dat {
					pinmux = <0xab02>;
				};

				pins_cmd3_dat {
					pinmux = <0xac02>;
				};
			};

			vow_clk_miso_off {
				phandle = <0x1e>;

				pins_cmd3_dat {
					bias-pull-down;
					input-enable;
					pinmux = <0x8f00>;
				};
			};

			vow_clk_miso_on {
				phandle = <0x1f>;

				pins_cmd3_dat {
					bias-disable;
					input-schmitt-enable;
					pinmux = <0x8f04>;
				};
			};

			vow_dat_miso_off {
				phandle = <0x1c>;

				pins_cmd1_dat {
					bias-pull-down;
					input-enable;
					pinmux = <0x8e00>;
				};
			};

			vow_dat_miso_on {
				phandle = <0x1d>;

				pins_cmd1_dat {
					bias-disable;
					input-schmitt-enable;
					pinmux = <0x8e04>;
				};
			};
		};
	};

	fragment@70 {
		target = <0xffffffff>;

		__overlay__ {
			compatible = "mediatek,md1_sim1_hot_plug_eint-eint";
			debounce = <0x0 0x186a0>;
			dedicated = <0x0 0x0>;
			interrupts = <0x0 0x4>;
			sockettype = <0x0 0x0>;
			src_pin = <0x0 0x1>;
			status = "okay";
		};
	};

	fragment@71 {
		target = <0xffffffff>;

		__overlay__ {
			compatible = "mediatek,md1_sim2_hot_plug_eint-eint";
			debounce = <0x1 0x186a0>;
			dedicated = <0x1 0x0>;
			interrupts = <0x1 0x4>;
			sockettype = <0x1 0x0>;
			src_pin = <0x1 0x2>;
			status = "okay";
		};
	};

	fragment@72 {
		target = <0xffffffff>;

		__overlay__ {
			regulator-default-on = <0x1>;
			regulator-name = "vcama1";
			status = "okay";
		};
	};

	fragment@73 {
		target = <0xffffffff>;

		__overlay__ {
			regulator-default-on = <0x1>;
			regulator-name = "vcama2";
			status = "okay";
		};
	};

	fragment@74 {
		target = <0xffffffff>;

		__overlay__ {
			regulator-default-on = <0x1>;
			regulator-name = "vsim1";
			status = "okay";
		};
	};

	fragment@75 {
		target = <0xffffffff>;

		__overlay__ {
			regulator-default-on = <0x1>;
			regulator-name = "vsim2";
			status = "okay";
		};
	};

	fragment@76 {
		target = <0xffffffff>;

		__overlay__ {
			regulator-default-on = <0x1>;
			regulator-name = "vcamd";
			status = "okay";
		};
	};

	fragment@77 {
		target = <0xffffffff>;

		__overlay__ {
			regulator-default-on = <0x1>;
			regulator-name = "vcamio";
			status = "okay";
		};
	};

	fragment@78 {
		target = <0xffffffff>;

		__overlay__ {
			regulator-default-on = <0x1>;
			regulator-name = "vldo28";
			status = "okay";
		};
	};

	fragment@79 {
		target = <0xffffffff>;

		__overlay__ {
			status = "okay";
			vcama-supply = <0xffffffff>;
			vcama_sub-supply = <0xffffffff>;
			vcamaf-supply = <0xffffffff>;
			vcamaf_main2-supply = <0xffffffff>;
			vcamaf_sub-supply = <0xffffffff>;
			vcamd_sub-supply = <0xffffffff>;
			vcamio-supply = <0xffffffff>;
			vcamio_main2-supply = <0xffffffff>;
			vcamio_sub-supply = <0xffffffff>;
		};
	};

	fragment@8 {
		target = <0xffffffff>;

		__overlay__ {

			consys_default {
				phandle = <0x20>;
			};

			fmlna@0 {
				phandle = <0x24>;

				pins_cmd_dat {
					bias-disable;
					output-low;
					pinmux = <0xa000>;
					slew-rate = <0x0>;
				};
			};

			fmlna@1 {
				phandle = <0x25>;

				pins_cmd_dat {
					output-high;
					pinmux = <0xa000>;
					slew-rate = <0x1>;
				};
			};

			fmlna@2 {
				phandle = <0x26>;

				pins_cmd_dat {
					output-low;
					pinmux = <0xa000>;
					slew-rate = <0x1>;
				};
			};

			gpslna@0 {
				phandle = <0x21>;

				pins_cmd_dat {
					bias-disable;
					output-low;
					pinmux = <0x9b00>;
					slew-rate = <0x0>;
				};
			};

			gpslna@1 {
				phandle = <0x22>;

				pins_cmd_dat {
					output-high;
					pinmux = <0x9b00>;
					slew-rate = <0x1>;
				};
			};

			gpslna@2 {
				phandle = <0x23>;

				pins_cmd_dat {
					output-low;
					pinmux = <0x9b00>;
					slew-rate = <0x1>;
				};
			};
		};
	};

	fragment@80 {
		target = <0xffffffff>;

		__overlay__ {
			status = "okay";
			vtouch-supply = <0xffffffff>;
		};
	};

	fragment@81 {
		target = <0xffffffff>;

		__overlay__ {
			mediatek,kpd-hw-dl-key0 = <0x11>;
			mediatek,kpd-hw-dl-key1 = <0x0>;
			mediatek,kpd-hw-dl-key2 = <0x8>;
			mediatek,kpd-hw-factory-key = <0x0>;
			mediatek,kpd-hw-init-map = <0x72 0x0 0x0 0x0 0x0 0x0 0x0 0x0 0x0 0x0 0x0 0x0 0x0 0x0 0x0 0x0 0x0 0x0 0x0 0x0 0x0 0x0 0x0 0x0 0x0 0x0 0x0 0x0 0x0 0x0 0x0 0x0 0x0 0x0 0x0 0x0 0x0 0x0 0x0 0x0 0x0 0x0 0x0 0x0 0x0 0x0 0x0 0x0 0x0 0x0 0x0 0x0 0x0 0x0 0x0 0x0 0x0 0x0 0x0 0x0 0x0 0x0 0x0 0x0 0x0 0x0 0x0 0x0 0x0 0x0 0x0 0x0>;
			mediatek,kpd-hw-map-num = <0x48>;
			mediatek,kpd-hw-pwrkey = <0x8>;
			mediatek,kpd-hw-recovery-key = <0x11>;
			mediatek,kpd-hw-rstkey = <0x11>;
			mediatek,kpd-key-debounce = <0x400>;
			mediatek,kpd-pwkey-gpio-din = <0x0>;
			mediatek,kpd-pwrkey-eint-gpio = <0x0>;
			mediatek,kpd-sw-pwrkey = <0x74>;
			mediatek,kpd-sw-rstkey = <0x73>;
			mediatek,kpd-use-extend-type = <0x0>;
			status = "okay";
		};
	};

	fragment@82 {
		target = <0xffffffff>;

		__overlay__ {

			cam0@0 {
				phandle = <0x44>;

				pins_cmd_dat {
					output-low;
					pinmux = <0x6500>;
					slew-rate = <0x1>;
				};
			};

			cam0@1 {
				phandle = <0x45>;

				pins_cmd_dat {
					output-high;
					pinmux = <0x6500>;
					slew-rate = <0x1>;
				};
			};

			cam0@2 {
				phandle = <0x46>;

				pins_cmd_dat {
					output-low;
					pinmux = <0x6100>;
					slew-rate = <0x1>;
				};
			};

			cam0@3 {
				phandle = <0x47>;

				pins_cmd_dat {
					output-high;
					pinmux = <0x6100>;
					slew-rate = <0x1>;
				};
			};

			cam0@vcam0 {
				phandle = <0x50>;

				pins_cmd_dat {
					output-low;
					pinmux = <0xa600>;
					slew-rate = <0x1>;
				};
			};

			cam0@vcam1 {
				phandle = <0x51>;

				pins_cmd_dat {
					output-high;
					pinmux = <0xa600>;
					slew-rate = <0x1>;
				};
			};

			cam0@vcam2 {
				phandle = <0x65>;

				pins_cmd_dat {
					output-low;
					pinmux = <0xb200>;
					slew-rate = <0x1>;
				};
			};

			cam0@vcam3 {
				phandle = <0x66>;

				pins_cmd_dat {
					output-high;
					pinmux = <0xb200>;
					slew-rate = <0x1>;
				};
			};

			cam1@0 {
				phandle = <0x48>;

				pins_cmd_dat {
					output-low;
					pinmux = <0x6600>;
					slew-rate = <0x1>;
				};
			};

			cam1@1 {
				phandle = <0x49>;

				pins_cmd_dat {
					output-high;
					pinmux = <0x6600>;
					slew-rate = <0x1>;
				};
			};

			cam1@2 {
				phandle = <0x4a>;

				pins_cmd_dat {
					output-low;
					pinmux = <0x6200>;
					slew-rate = <0x1>;
				};
			};

			cam1@3 {
				phandle = <0x4b>;

				pins_cmd_dat {
					output-high;
					pinmux = <0x6200>;
					slew-rate = <0x1>;
				};
			};

			cam1@vcam0 {
				phandle = <0x67>;

				pins_cmd_dat {
					output-low;
					pinmux = <0x4f00>;
					slew-rate = <0x1>;
				};
			};

			cam1@vcam1 {
				phandle = <0x68>;

				pins_cmd_dat {
					output-high;
					pinmux = <0x4f00>;
					slew-rate = <0x1>;
				};
			};

			cam1@vcam2 {
				phandle = <0x54>;

				pins_cmd_dat {
					output-low;
					pinmux = <0xa900>;
					slew-rate = <0x1>;
				};
			};

			cam1@vcam3 {
				phandle = <0x55>;

				pins_cmd_dat {
					output-high;
					pinmux = <0xa900>;
					slew-rate = <0x1>;
				};
			};

			cam1@vcam4 {
				phandle = <0x69>;

				pins_cmd_dat {
					output-low;
					pinmux = <0x9f00>;
					slew-rate = <0x1>;
				};
			};

			cam1@vcam5 {
				phandle = <0x6a>;

				pins_cmd_dat {
					output-high;
					pinmux = <0x9f00>;
					slew-rate = <0x1>;
				};
			};

			cam2@0 {
				phandle = <0x4c>;

				pins_cmd_dat {
					output-low;
					pinmux = <0x6d00>;
					slew-rate = <0x1>;
				};
			};

			cam2@1 {
				phandle = <0x4d>;

				pins_cmd_dat {
					output-high;
					pinmux = <0x6d00>;
					slew-rate = <0x1>;
				};
			};

			cam2@3 {
				phandle = <0x4e>;

				pins_cmd_dat {
					output-low;
					pinmux = <0x6b00>;
					slew-rate = <0x1>;
				};
			};

			cam2@4 {
				phandle = <0x4f>;

				pins_cmd_dat {
					output-high;
					pinmux = <0x6b00>;
					slew-rate = <0x1>;
				};
			};

			cam2@vcam0 {
				phandle = <0x52>;

				pins_cmd_dat {
					output-low;
					pinmux = <0xa900>;
					slew-rate = <0x1>;
				};
			};

			cam2@vcam1 {
				phandle = <0x53>;

				pins_cmd_dat {
					output-high;
					pinmux = <0xa900>;
					slew-rate = <0x1>;
				};
			};

			cam3@0 {
				phandle = <0x6b>;

				pins_cmd_dat {
					output-low;
					pinmux = <0x7000>;
					slew-rate = <0x1>;
				};
			};

			cam3@1 {
				phandle = <0x6c>;

				pins_cmd_dat {
					output-high;
					pinmux = <0x7000>;
					slew-rate = <0x1>;
				};
			};

			cam3@2 {
				phandle = <0x6d>;

				pins_cmd_dat {
					output-low;
					pinmux = <0x6e00>;
					slew-rate = <0x1>;
				};
			};

			cam3@3 {
				phandle = <0x6e>;

				pins_cmd_dat {
					output-high;
					pinmux = <0x6e00>;
					slew-rate = <0x1>;
				};
			};

			cam3@vcam0 {
				phandle = <0x6f>;

				pins_cmd_dat {
					output-low;
					pinmux = <0x1c00>;
					slew-rate = <0x1>;
				};
			};

			cam3@vcam1 {
				phandle = <0x70>;

				pins_cmd_dat {
					output-high;
					pinmux = <0x1c00>;
					slew-rate = <0x1>;
				};
			};

			cam3@vcam2 {
				phandle = <0x71>;

				pins_cmd_dat {
					output-low;
					pinmux = <0x9f00>;
					slew-rate = <0x1>;
				};
			};

			cam3@vcam3 {
				phandle = <0x72>;

				pins_cmd_dat {
					output-high;
					pinmux = <0x9f00>;
					slew-rate = <0x1>;
				};
			};

			cam_mipi_switch_en_0 {
				phandle = <0x73>;

				pins_cmd_dat {
					output-low;
					pinmux = <0x1900>;
					slew-rate = <0x1>;
				};
			};

			cam_mipi_switch_en_1 {
				phandle = <0x74>;

				pins_cmd_dat {
					output-high;
					pinmux = <0x1900>;
					slew-rate = <0x1>;
				};
			};

			cam_mipi_switch_sel_0 {
				phandle = <0x75>;

				pins_cmd_dat {
					output-low;
					pinmux = <0x1a00>;
					slew-rate = <0x1>;
				};
			};

			cam_mipi_switch_sel_1 {
				phandle = <0x76>;

				pins_cmd_dat {
					output-high;
					pinmux = <0x1a00>;
					slew-rate = <0x1>;
				};
			};

			camdefault {
				phandle = <0x43>;
			};

			camera_pins_cam0_mclk_2ma {
				phandle = <0x57>;

				pins_cmd_dat {
					drive-strength = <0x0>;
					pinmux = <0x6301>;
				};
			};

			camera_pins_cam0_mclk_4ma {
				phandle = <0x58>;

				pins_cmd_dat {
					drive-strength = <0x1>;
					pinmux = <0x6301>;
				};
			};

			camera_pins_cam0_mclk_6ma {
				phandle = <0x59>;

				pins_cmd_dat {
					drive-strength = <0x2>;
					pinmux = <0x6301>;
				};
			};

			camera_pins_cam0_mclk_8ma {
				phandle = <0x5a>;

				pins_cmd_dat {
					drive-strength = <0x3>;
					pinmux = <0x6301>;
				};
			};

			camera_pins_cam0_mclk_off {
				phandle = <0x56>;

				pins_cmd_dat {
					drive-strength = <0x1>;
					pinmux = <0x6300>;
				};
			};

			camera_pins_cam1_mclk_2ma {
				phandle = <0x5c>;

				pins_cmd_dat {
					drive-strength = <0x0>;
					pinmux = <0x6401>;
				};
			};

			camera_pins_cam1_mclk_4ma {
				phandle = <0x5d>;

				pins_cmd_dat {
					drive-strength = <0x1>;
					pinmux = <0x6401>;
				};
			};

			camera_pins_cam1_mclk_6ma {
				phandle = <0x5e>;

				pins_cmd_dat {
					drive-strength = <0x2>;
					pinmux = <0x6401>;
				};
			};

			camera_pins_cam1_mclk_8ma {
				phandle = <0x5f>;

				pins_cmd_dat {
					drive-strength = <0x3>;
					pinmux = <0x6401>;
				};
			};

			camera_pins_cam1_mclk_off {
				phandle = <0x5b>;

				pins_cmd_dat {
					drive-strength = <0x1>;
					pinmux = <0x6400>;
				};
			};

			camera_pins_cam2_mclk_2ma {
				phandle = <0x61>;

				pins_cmd_dat {
					drive-strength = <0x0>;
					pinmux = <0x6c01>;
				};
			};

			camera_pins_cam2_mclk_4ma {
				phandle = <0x62>;

				pins_cmd_dat {
					drive-strength = <0x1>;
					pinmux = <0x6c01>;
				};
			};

			camera_pins_cam2_mclk_6ma {
				phandle = <0x63>;

				pins_cmd_dat {
					drive-strength = <0x2>;
					pinmux = <0x6c01>;
				};
			};

			camera_pins_cam2_mclk_8ma {
				phandle = <0x64>;

				pins_cmd_dat {
					drive-strength = <0x3>;
					pinmux = <0x6c01>;
				};
			};

			camera_pins_cam2_mclk_off {
				phandle = <0x60>;

				pins_cmd_dat {
					drive-strength = <0x1>;
					pinmux = <0x6c00>;
				};
			};

			camera_pins_cam3_mclk_2ma {
				phandle = <0x9f>;

				pins_cmd_dat {
					drive-strength = <0x0>;
					pinmux = <0x6301>;
				};
			};

			camera_pins_cam3_mclk_4ma {
				phandle = <0xa0>;

				pins_cmd_dat {
					drive-strength = <0x1>;
					pinmux = <0x6301>;
				};
			};

			camera_pins_cam3_mclk_6ma {
				phandle = <0xa1>;

				pins_cmd_dat {
					drive-strength = <0x2>;
					pinmux = <0x6301>;
				};
			};

			camera_pins_cam3_mclk_8ma {
				phandle = <0xa2>;

				pins_cmd_dat {
					drive-strength = <0x3>;
					pinmux = <0x6301>;
				};
			};

			camera_pins_cam3_mclk_off {
				phandle = <0x9e>;

				pins_cmd_dat {
					drive-strength = <0x1>;
					pinmux = <0x6300>;
				};
			};
		};
	};

	fragment@83 {
		target = <0xffffffff>;

		__overlay__ {
			cam0_vcama-supply = <0xffffffff>;
			cam0_vcamio-supply = <0xffffffff>;
			cam1_vcama-supply = <0xffffffff>;
			cam1_vcamd-supply = <0xffffffff>;
			cam1_vcamio-supply = <0xffffffff>;
			cam2_vcama-supply = <0xffffffff>;
			cam2_vcamd-supply = <0xffffffff>;
			cam2_vcamio-supply = <0xffffffff>;
			cam3_vcamio-supply = <0xffffffff>;
			pinctrl-0 = <0x43>;
			pinctrl-1 = <0x44>;
			pinctrl-10 = <0x4d>;
			pinctrl-11 = <0x4e>;
			pinctrl-12 = <0x4f>;
			pinctrl-13 = <0x50>;
			pinctrl-14 = <0x51>;
			pinctrl-15 = <0x52>;
			pinctrl-16 = <0x53>;
			pinctrl-17 = <0x54>;
			pinctrl-18 = <0x55>;
			pinctrl-19 = <0x56>;
			pinctrl-2 = <0x45>;
			pinctrl-20 = <0x57>;
			pinctrl-21 = <0x58>;
			pinctrl-22 = <0x59>;
			pinctrl-23 = <0x5a>;
			pinctrl-24 = <0x5b>;
			pinctrl-25 = <0x5c>;
			pinctrl-26 = <0x5d>;
			pinctrl-27 = <0x5e>;
			pinctrl-28 = <0x5f>;
			pinctrl-29 = <0x60>;
			pinctrl-3 = <0x46>;
			pinctrl-30 = <0x61>;
			pinctrl-31 = <0x62>;
			pinctrl-32 = <0x63>;
			pinctrl-33 = <0x64>;
			pinctrl-34 = <0x56>;
			pinctrl-35 = <0x57>;
			pinctrl-36 = <0x58>;
			pinctrl-37 = <0x59>;
			pinctrl-38 = <0x5a>;
			pinctrl-39 = <0x65>;
			pinctrl-4 = <0x47>;
			pinctrl-40 = <0x66>;
			pinctrl-41 = <0x67>;
			pinctrl-42 = <0x68>;
			pinctrl-43 = <0x69>;
			pinctrl-44 = <0x6a>;
			pinctrl-45 = <0x6b>;
			pinctrl-46 = <0x6c>;
			pinctrl-47 = <0x6d>;
			pinctrl-48 = <0x6e>;
			pinctrl-49 = <0x6f>;
			pinctrl-5 = <0x48>;
			pinctrl-50 = <0x70>;
			pinctrl-51 = <0x71>;
			pinctrl-52 = <0x72>;
			pinctrl-53 = <0x73>;
			pinctrl-54 = <0x74>;
			pinctrl-55 = <0x75>;
			pinctrl-56 = <0x76>;
			pinctrl-6 = <0x49>;
			pinctrl-7 = <0x4a>;
			pinctrl-8 = <0x4b>;
			pinctrl-9 = <0x4c>;
			pinctrl-names = "default", "cam0_rst0", "cam0_rst1", "cam0_pnd0", "cam0_pnd1", "cam1_rst0", "cam1_rst1", "cam1_pnd0", "cam1_pnd1", "cam2_rst0", "cam2_rst1", "cam2_pnd0", "cam2_pnd1", "cam0_ldo_vcamd_0", "cam0_ldo_vcamd_1", "cam2_ldo_vcamd_0", "cam2_ldo_vcamd_1", "cam2_ldo_vcama_0", "cam2_ldo_vcama_1", "cam0_mclk_off", "cam0_mclk_2mA", "cam0_mclk_4mA", "cam0_mclk_6mA", "cam0_mclk_8mA", "cam1_mclk_off", "cam1_mclk_2mA", "cam1_mclk_4mA", "cam1_mclk_6mA", "cam1_mclk_8mA", "cam2_mclk_off", "cam2_mclk_2mA", "cam2_mclk_4mA", "cam2_mclk_6mA", "cam2_mclk_8mA", "cam3_mclk_off", "cam3_mclk_2mA", "cam3_mclk_4mA", "cam3_mclk_6mA", "cam3_mclk_8mA", "cam0_ldo_vcama_0", "cam0_ldo_vcama_1", "cam1_ldo_vcama_0", "cam1_ldo_vcama_1", "cam1_ldo_vcamd_0", "cam1_ldo_vcamd_1", "cam3_rst0", "cam3_rst1", "cam3_pnd0", "cam3_pnd1", "cam3_ldo_vcama_0", "cam3_ldo_vcama_1", "cam3_ldo_vcamd_0", "cam3_ldo_vcamd_1", "cam_mipi_switch_en_0", "cam_mipi_switch_en_1", "cam_mipi_switch_sel_0", "cam_mipi_switch_sel_1";
			status = "okay";
		};
	};

	fragment@9 {
		target = <0xffffffff>;

		__overlay__ {
			pinctrl-0 = <0x20>;
			pinctrl-1 = <0x21>;
			pinctrl-2 = <0x22>;
			pinctrl-3 = <0x23>;
			pinctrl-4 = <0x24>;
			pinctrl-5 = <0x25>;
			pinctrl-6 = <0x26>;
			pinctrl-names = "default", "gps_lna_state_init", "gps_lna_state_oh", "gps_lna_state_ol", "fm_lna_state_init", "fm_lna_state_oh", "fm_lna_state_ol";
			status = "okay";
		};
	};
};
